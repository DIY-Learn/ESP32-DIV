#ifndef IR_MENU_H
#define IR_MENU_H

#include <TFT_eSPI.h>
#include <IRrecv.h>
#include <IRsend.h>
#include <IRutils.h>
#include <SPIFFS.h>

extern TFT_eSPI tft;
extern bool readButtonOnce(int pin);
extern void drawStatusBarBright();
extern void drawRoundedIcon(int x, int y, int w, int h, const uint16_t* icon, int radius);
extern bool feature_exit_requested;
extern bool feature_active;
extern int irSelected;

#define IR_RX_PIN  1
#define IR_TX_PIN  20

IRrecv irrecv(IR_RX_PIN);
IRsend irsend(IR_TX_PIN);

#ifndef BG
#define BG        0x0000
#define TILE      0x2104
#define SELECT    0xFD20
#define GREEN     0x07E0
#define WHITE     0xFFFF
#define RED       0xF800
#define YELLOW    0xFFE0
#endif

const char* irAttacks[] = {
  "Capture IR",
  "Replay IR",
  "Brute Force",
  "Back to Main Menu"
};
#define IR_ATTACK_COUNT 4

// Replace with your own 32x32 RGB565 icons
const uint16_t icon_capture[] PROGMEM = {0xffff, 0xffff, 0xffff, 0xffff, 0xffff, 0xffff, 0xffff, 0xffff, 0xffff, 0xffff, 0xffff, 0xffff, 0xffff, 0xffff, 0xffff, 0xf7be, 
0xf7be, 0xffff, 0xffff, 0xffff, 0xffff, 0xffff, 0xffff, 0xffff, 0xffff, 0xffff, 0xffff, 0xffff, 0xffff, 0xffff, 0xffff, 0xffff, 
0xffff, 0xffff, 0xffff, 0xffff, 0xffff, 0xffff, 0xffff, 0xffff, 0xffff, 0xffff, 0xd69a, 0x9492, 0x630c, 0x4228, 0x2124, 0x1082, 
0x0861, 0x2104, 0x4208, 0x5aeb, 0x8c51, 0xce59, 0xffdf, 0xffff, 0xffff, 0xffff, 0xffff, 0xffff, 0xffff, 0xffff, 0xffff, 0xffff, 
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0xdedb, 0xdedb, 0xdedb, 0xdedb, 0xdedb, 0xdedb, 0xdedb, 0xdedb, 0xdedb, 0xdedb, 0xdedb, 0xdedb, 0xffdf, 0xffff, 0xffff, 0xffff};
const uint16_t icon_replay[] PROGMEM = {0xffff, 0xffff, 0xffff, 0xffff, 0xffff, 0xffff, 0xffff, 0xffff, 0xffff, 0xffff, 0xffff, 0xffff, 0xffff, 0xffff, 0xffff, 0xffff, 
0xffff, 0xffff, 0xffff, 0xffff, 0xffff, 0xffff, 0xffff, 0xffff, 0xffff, 0xffff, 0xffff, 0xffff, 0xffff, 0xffff, 0xffff, 0xffff, 
0xffff, 0xffff, 0xffff, 0xffff, 0xffff, 0xffff, 0xffff, 0xffff, 0xffff, 0xffff, 0xffff, 0xffff, 0xffff, 0xffff, 0xffff, 0xffff, 
0xffff, 0xffff, 0xffff, 0xffff, 0xffff, 0xffff, 0xffff, 0xffff, 0xffff, 0xffff, 0xffff, 0xffff, 0xffff, 0xffff, 0xffff, 0xffff, 
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0xffff, 0xffff, 0xffff, 0xffff, 0xffff, 0xffff, 0xffff, 0xffff, 0xffff, 0xffff, 0xffff, 0xffff, 0xffff, 0xffff, 0xffff, 0xffff};
const uint16_t icon_brute[] PROGMEM = {0xffff, 0xffff, 0xffff, 0xffff, 0xffff, 0xffff, 0xffff, 0xce59, 0xad75, 0xad75, 0xad75, 0xad75, 0xad75, 0xad75, 0xad75, 0xad75, 
0xad75, 0xad75, 0xad75, 0xad75, 0xad75, 0xad75, 0xad75, 0xad75, 0xad75, 0xdedb, 0xffff, 0xffff, 0xffff, 0xffff, 0xffff, 0xffff, 
0xffff, 0xffff, 0xffff, 0xffff, 0xffff, 0xffff, 0xa514, 0x18e3, 0x52aa, 0x528a, 0x528a, 0x528a, 0x528a, 0x528a, 0x528a, 0x630c, 
0x6b4d, 0x5acb, 0x528a, 0x528a, 0x528a, 0x528a, 0x528a, 0x52aa, 0x528a, 0x2945, 0xef5d, 0xffff, 0xffff, 0xffff, 0xffff, 0xffff, 
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0x9492, 0x9492, 0x9cd3, 0xce59, 0xffff, 0xffff, 0xffff, 0xffff, 0xffff, 0xffff, 0xffff, 0xffff, 0xffff, 0xffff, 0xffff, 0xffff

};
const uint16_t icon_back_ir[] PROGMEM = {0xffff, 0xffff, 0xffff, 0xffff, 0xffff, 0xffff, 0xffff, 0xffff, 0xffff, 0xffff, 0xffff, 0xffff, 0xffff, 0xffff, 0xffff, 0xffff, 
0xffff, 0xffff, 0xffff, 0xffff, 0xffff, 0xffff, 0xffff, 0xffff, 0xffff, 0xffff, 0xffff, 0xffff, 0xffff, 0xffff, 0xffff, 0xffff, 
0xffff, 0xffff, 0xffff, 0xffff, 0xffff, 0xffff, 0xffff, 0xffff, 0xffff, 0xffff, 0xffff, 0xffff, 0xffff, 0xffff, 0xffff, 0xffff, 
0xffff, 0xffff, 0xffff, 0xffff, 0xffff, 0xffff, 0xffff, 0xffff, 0xffff, 0xffff, 0xffff, 0xffff, 0xffff, 0xffff, 0xffff, 0xffff, 
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0xffff, 0xffff, 0xffff, 0xffff, 0xffff, 0xffff, 0xffff, 0xffff, 0xffff, 0xffff, 0xffff, 0xffff, 0xffff, 0xffff, 0xffff, 0xffff};

void drawIRMenu();
bool handleIRMenu();
void captureIR();
void replayIR();
void bruteForceIR();

void drawIRMenu() {
  tft.fillRect(0, 23, 240, 297, BG);
  drawStatusBarBright();
  tft.setTextColor(WHITE, BG);
  tft.setTextSize(1);
  tft.setCursor(10, 35);
  tft.print("IR Attacks");

  for (int i = 0; i < IR_ATTACK_COUNT; i++) {
    int y = 55 + i * 36;
    if (i == IR_ATTACK_COUNT - 1) y += 5;
    uint16_t color = (i == irSelected) ? SELECT : GREEN;
    tft.setTextColor(color, BG);
    int iconX = 10;
    int iconY = y - 12;
    const uint16_t* iconPtr = nullptr;
    switch (i) {
      case 0: iconPtr = icon_capture; break;
      case 1: iconPtr = icon_replay; break;
      case 2: iconPtr = icon_brute; break;
      case 3: iconPtr = icon_back_ir; break;
    }
    drawRoundedIcon(iconX, iconY, 32, 32, iconPtr, 6);
    tft.setCursor(50, y);
    tft.print(irAttacks[i]);
  }
}

bool handleIRMenu() {
  int old = irSelected;
  bool redraw = false;

  if (readButtonOnce(BTN_UP)) {
    irSelected = (irSelected - 1 + IR_ATTACK_COUNT) % IR_ATTACK_COUNT;
    redraw = true;
  }
  else if (readButtonOnce(BTN_DOWN)) {
    irSelected = (irSelected + 1) % IR_ATTACK_COUNT;
    redraw = true;
  }
  else if (readButtonOnce(BTN_OK)) {
    if (irSelected == IR_ATTACK_COUNT - 1) return true;
    feature_active = true;
    feature_exit_requested = false;
    switch (irSelected) {
      case 0: captureIR(); break;
      case 1: replayIR(); break;
      case 2: bruteForceIR(); break;
    }
    feature_active = false;
    drawIRMenu();
    redraw = false;
  }

  if (redraw) {
    int oldY = 55 + old * 36 + (old == IR_ATTACK_COUNT - 1 ? 5 : 0);
    int newY = 55 + irSelected * 36 + (irSelected == IR_ATTACK_COUNT - 1 ? 5 : 0);
    tft.fillRect(50, oldY - 8, 150, 20, BG);
    tft.setTextColor(GREEN, BG);
    tft.setCursor(50, oldY);
    tft.print(irAttacks[old]);
    tft.fillRect(50, newY - 8, 150, 20, BG);
    tft.setTextColor(SELECT, BG);
    tft.setCursor(50, newY);
    tft.print(irAttacks[irSelected]);
  }
  return false;
}

void captureIR() {
  tft.fillRect(0, 23, 240, 297, BG);
  drawStatusBarBright();
  tft.setTextColor(GREEN, BG);
  tft.setCursor(10, 35);
  tft.print("Capture IR");
  tft.setCursor(10, 55);
  tft.print("Point remote at sensor");
  tft.setCursor(10, 75);
  tft.print("Press any button to capture");
  tft.setCursor(10, 95);
  tft.print("Press LEFT to exit");

  irrecv.enableIRIn();
  while (!feature_exit_requested) {
    if (readButtonOnce(BTN_LEFT)) { irrecv.disableIRIn(); return; }
    if (readButtonOnce(BTN_OK) || readButtonOnce(BTN_UP) || readButtonOnce(BTN_DOWN)) {
      tft.fillRect(10, 115, 220, 20, BG);
      tft.setTextColor(YELLOW, BG);
      tft.setCursor(10, 115);
      tft.print("Listening...");

      decode_results results;
      unsigned long start = millis();
      bool received = false;
      while (millis() - start < 5000) {
        if (irrecv.decode(&results)) {
          received = true;
          break;
        }
        if (readButtonOnce(BTN_LEFT)) { irrecv.disableIRIn(); return; }
        delay(10);
      }
      if (!received) {
        tft.fillRect(10, 135, 220, 20, BG);
        tft.setTextColor(RED, BG);
        tft.setCursor(10, 135);
        tft.print("No signal! Try again.");
        delay(1500);
        continue;
      }

      if (!SPIFFS.begin(true)) {
        tft.setCursor(10, 135);
        tft.print("SPIFFS mount failed!");
        delay(1500);
        continue;
      }
      File f = SPIFFS.open("/ir_signal.bin", FILE_WRITE);
      if (!f) {
        tft.setCursor(10, 135);
        tft.print("Failed to open file");
        delay(1500);
      } else {
        // Cast away volatile for rawbuf
        uint16_t* rawbuf = (uint16_t*)results.rawbuf;
        uint16_t rawlen = results.rawlen;
        f.write((uint8_t*)rawbuf, rawlen * sizeof(uint16_t));
        f.close();
        tft.fillRect(10, 135, 220, 20, BG);
        tft.setTextColor(GREEN, BG);
        tft.setCursor(10, 135);
        tft.print("Signal saved!");
        delay(1500);
      }
      break;
    }
    delay(50);
  }
  irrecv.disableIRIn();
  feature_exit_requested = false;
}

void replayIR() {
  tft.fillRect(0, 23, 240, 297, BG);
  drawStatusBarBright();
  tft.setTextColor(GREEN, BG);
  tft.setCursor(10, 35);
  tft.print("Replay IR");
  tft.setCursor(10, 55);
  tft.print("Press OK to send");
  tft.setCursor(10, 75);
  tft.print("Press LEFT to exit");

  if (!SPIFFS.begin(true)) {
    tft.setCursor(10, 95);
    tft.print("SPIFFS mount failed!");
    delay(1500);
    return;
  }
  File f = SPIFFS.open("/ir_signal.bin", FILE_READ);
  if (!f) {
    tft.setCursor(10, 95);
    tft.setTextColor(RED, BG);
    tft.print("No captured signal!");
    tft.setCursor(10, 115);
    tft.print("Capture first.");
    delay(2000);
    return;
  }
  size_t len = f.size();
  if (len == 0) {
    tft.setCursor(10, 95);
    tft.print("Empty signal file!");
    delay(1500);
    f.close();
    return;
  }
  uint16_t* rawbuf = (uint16_t*)malloc(len);
  if (!rawbuf) {
    tft.setCursor(10, 95);
    tft.print("Out of memory!");
    delay(1500);
    f.close();
    return;
  }
  f.read((uint8_t*)rawbuf, len);
  f.close();
  uint16_t rawlen = len / sizeof(uint16_t);

  irsend.begin();
  while (!feature_exit_requested) {
    if (readButtonOnce(BTN_OK)) {
      tft.fillRect(10, 95, 220, 20, BG);
      tft.setTextColor(YELLOW, BG);
      tft.setCursor(10, 95);
      tft.print("Sending...");
      irsend.sendRaw(rawbuf, rawlen, 38);
      tft.fillRect(10, 95, 220, 20, BG);
      tft.setTextColor(GREEN, BG);
      tft.setCursor(10, 95);
      tft.print("Sent!");
      delay(500);
    }
    if (readButtonOnce(BTN_LEFT)) break;
    delay(50);
  }
  free(rawbuf);
  feature_exit_requested = false;
}

void bruteForceIR() {
  tft.fillRect(0, 23, 240, 297, BG);
  drawStatusBarBright();
  tft.setTextColor(GREEN, BG);
  tft.setCursor(10, 35);
  tft.print("Brute Force IR");
  tft.setCursor(10, 55);
  tft.print("Coming soon...");
  tft.setCursor(10, 75);
  tft.print("Press LEFT to exit");
  while (!readButtonOnce(BTN_LEFT)) delay(50);
  feature_exit_requested = false;
}

#endif