#ifndef RF24_MENU_H
#define RF24_MENU_H

#include <TFT_eSPI.h>
#include <SPI.h>
#include <RF24.h>

extern TFT_eSPI tft;
extern bool readButtonOnce(int pin);
extern void drawStatusBarBright();
extern void drawRoundedIcon(int x, int y, int w, int h, const uint16_t* icon, int radius);
extern int rf24Selected; 

// Colors (should be defined elsewhere, but safe)
#ifndef BG
#define BG        0x0000
#define TILE      0x2104
#define SELECT    0xFD20
#define GREEN     0x07E0
#define WHITE     0xFFFF
#define RED       0xF800
#define YELLOW    0xFFE0
#endif

// ========== NRF24L01 Pin Definitions ==========
#define NRF_CE_PIN   17
#define NRF_CSN_PIN  3  // Use free pin (not 3 – conflicts with LCD_RD)
#define NRF_SCK_PIN  18
#define NRF_MOSI_PIN 11
#define NRF_MISO_PIN 6

// ========== Menu items ==========
const char* rf24Attacks[] = {
  "NRF24 Jammer",
  "NRF24 Scanner",
  "Back to Main Menu"
};
#define RF24_ATTACK_COUNT 3

// ========== Global variable for menu selection ==========
int rf24Selected = 0;   // <-- THIS WAS MISSING

// Icons (Placeholders – replace with your own 32x32 RGB565 arrays)
const uint16_t icon_nrf_jammer[1024] = {0xffff, 0xffff, 0xffff, 0xffff, 0xffff, 0xffff, 0xffff, 0xffff, 0xffff, 0xffff, 0xffff, 0xffff, 0xffff, 0xffff, 0xffff, 0xffff, 
0xffff, 0xffff, 0xffff, 0xffff, 0xffff, 0xffff, 0xffff, 0xffff, 0xffff, 0xffff, 0xffff, 0xffff, 0xffff, 0xffff, 0xffff, 0xffff, 
0xffff, 0xffff, 0xffff, 0xffff, 0xffff, 0xffff, 0xffff, 0xffff, 0xffff, 0xffff, 0xffff, 0xffff, 0xffff, 0xffff, 0xffff, 0xffff, 
0xffff, 0xffff, 0xffff, 0xffff, 0xffff, 0xffff, 0xffff, 0xffff, 0xffff, 0xffff, 0xffff, 0xffff, 0xffff, 0xffff, 0xffff, 0xffff, 
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0xffff, 0xffff, 0xffff, 0xffff, 0xffff, 0xffff, 0xffff, 0xffff, 0xffff, 0xffff, 0xffff, 0xffff, 0xffff, 0xffff, 0xffff, 0xffff
};
const uint16_t icon_nrf_scanner[1024] = {0xffff, 0xffff, 0xffff, 0xffff, 0xffff, 0xffff, 0xffff, 0xffff, 0xffff, 0xffff, 0xffff, 0xffff, 0xffff, 0xffff, 0xffff, 0xffff, 
0xffff, 0xffff, 0xffff, 0xffff, 0xffff, 0xffff, 0xffff, 0xffff, 0xffff, 0xffff, 0xffff, 0xffff, 0xffff, 0xffff, 0xffff, 0xffff, 
0xffff, 0xffff, 0xffff, 0xffff, 0xffff, 0xffff, 0xffff, 0xffff, 0x9cd3, 0x31a7, 0x4208, 0x4228, 0x4228, 0x4228, 0x4228, 0x4228, 
0x4228, 0x4228, 0x4228, 0x4228, 0x4228, 0x4208, 0x31a7, 0x8410, 0xffff, 0xffff, 0xffff, 0xffff, 0xffff, 0xffff, 0xffff, 0xffff, 
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0xdedb, 0xdedb, 0xdedb, 0xd6bb, 0xe71c, 0xffff, 0xffff, 0xffff, 0xffff, 0xffff, 0xffff, 0xffff, 0xffff, 0xffff, 0xffff, 0xffff};
const uint16_t icon_back_rf[1024] = {0};

// Forward declarations
void drawRF24Menu();
bool handleRF24Menu();
void runNRF24Jammer();
void runNRF24Scanner();

// ========== Drawing function ==========
void drawRF24Menu() {
  tft.fillRect(0, 23, 240, 297, BG);
  drawStatusBarBright();
  tft.setTextColor(WHITE, BG);
  tft.setTextSize(1);
  tft.setCursor(10, 35);
  tft.print("2.4 GHz Attacks");

  for (int i = 0; i < RF24_ATTACK_COUNT; i++) {
    int y = 55 + i * 36;
    if (i == RF24_ATTACK_COUNT - 1) y += 5;
    uint16_t color = (i == rf24Selected) ? SELECT : GREEN;
    tft.setTextColor(color, BG);
    int iconX = 10;
    int iconY = y - 12;
    const uint16_t* iconPtr = nullptr;
    switch (i) {
      case 0: iconPtr = icon_nrf_jammer; break;
      case 1: iconPtr = icon_nrf_scanner; break;
      case 2: iconPtr = icon_back_rf; break;
    }
    drawRoundedIcon(iconX, iconY, 32, 32, iconPtr, 6);
    tft.setCursor(50, y);
    tft.print(rf24Attacks[i]);
  }
}

// ========== Menu handler ==========
bool handleRF24Menu() {
  int old = rf24Selected;
  bool redraw = false;

  if (readButtonOnce(BTN_UP)) {
    rf24Selected = (rf24Selected - 1 + RF24_ATTACK_COUNT) % RF24_ATTACK_COUNT;
    redraw = true;
  }
  else if (readButtonOnce(BTN_DOWN)) {
    rf24Selected = (rf24Selected + 1) % RF24_ATTACK_COUNT;
    redraw = true;
  }
  else if (readButtonOnce(BTN_OK)) {
    if (rf24Selected == RF24_ATTACK_COUNT - 1) return true;
    switch (rf24Selected) {
      case 0: runNRF24Jammer(); break;
      case 1: runNRF24Scanner(); break;
    }
    drawRF24Menu();
    redraw = false;
  }

  if (redraw) {
    int oldY = 55 + old * 36 + (old == RF24_ATTACK_COUNT - 1 ? 5 : 0);
    int newY = 55 + rf24Selected * 36 + (rf24Selected == RF24_ATTACK_COUNT - 1 ? 5 : 0);
    tft.fillRect(50, oldY - 8, 150, 20, BG);
    tft.setTextColor(GREEN, BG);
    tft.setCursor(50, oldY);
    tft.print(rf24Attacks[old]);
    tft.fillRect(50, newY - 8, 150, 20, BG);
    tft.setTextColor(SELECT, BG);
    tft.setCursor(50, newY);
    tft.print(rf24Attacks[rf24Selected]);
  }
  return false;
}

// ========== Attack: NRF24 Jammer ==========
void runNRF24Jammer() {
  tft.fillRect(0, 23, 240, 297, BG);
  drawStatusBarBright();
  tft.setTextColor(GREEN, BG);
  tft.setCursor(10, 35);
  tft.print("NRF24 Jammer");
  tft.setCursor(10, 55);
  tft.print("OK: start/stop");
  tft.setCursor(10, 75);
  tft.print("LEFT: exit");

  SPI.begin(NRF_SCK_PIN, NRF_MISO_PIN, NRF_MOSI_PIN);
  RF24 radio(NRF_CE_PIN, NRF_CSN_PIN);
  
  if (!radio.begin()) {
    tft.setTextColor(RED, BG);
    tft.setCursor(10, 95);
    tft.print("NRF24L01 NOT DETECTED!");
    tft.setCursor(10, 115);
    tft.print("Check wiring.");
    delay(2000);
    return;
  }
  
  radio.setAutoAck(false);
  radio.stopListening();
  radio.setRetries(0, 0);
  radio.setPALevel(RF24_PA_MAX, true);
  radio.setDataRate(RF24_2MBPS);
  radio.setCRCLength(RF24_CRC_DISABLED);

  bool active = false;
  const int jamChannels[] = {2, 26, 80, 37, 38, 39};
  int jamCount = sizeof(jamChannels)/sizeof(jamChannels[0]);
  int chIdx = 0;
  
  extern bool feature_exit_requested;  // from main
  while (!feature_exit_requested) {
    if (readButtonOnce(BTN_OK)) {
      active = !active;
      if (active) {
        tft.fillRect(10, 95, 220, 20, BG);
        tft.setTextColor(RED, BG);
        tft.setCursor(10, 95);
        tft.print(">>> JAMMING ACTIVE <<<");
        radio.startConstCarrier(RF24_PA_MAX, jamChannels[chIdx]);
      } else {
        radio.stopConstCarrier();
        tft.fillRect(10, 95, 220, 20, BG);
      }
      delay(200);
    }
    if (readButtonOnce(BTN_LEFT)) break;

    if (active) {
      radio.stopConstCarrier();
      chIdx = (chIdx + 1) % jamCount;
      radio.startConstCarrier(RF24_PA_MAX, jamChannels[chIdx]);
      delay(20);
    }
    delay(50);
  }
  radio.stopConstCarrier();
  radio.powerDown();
}

// ========== Attack: NRF24 Scanner ==========
void runNRF24Scanner() {
  tft.fillRect(0, 23, 240, 297, BG);
  drawStatusBarBright();
  tft.setTextColor(GREEN, BG);
  tft.setCursor(10, 35);
  tft.print("NRF24 Scanner");
  tft.setCursor(10, 55);
  tft.print("Scanning channels 0-125...");
  
  SPI.begin(NRF_SCK_PIN, NRF_MISO_PIN, NRF_MOSI_PIN);
  RF24 radio(NRF_CE_PIN, NRF_CSN_PIN);
  if (!radio.begin()) {
    tft.setTextColor(RED, BG);
    tft.setCursor(10, 75);
    tft.print("NRF24 not found!");
    delay(2000);
    return;
  }
  radio.setPALevel(RF24_PA_LOW);
  radio.startListening();
  
  int y = 75;
  tft.setTextColor(WHITE, BG);
  for (int ch = 0; ch <= 125; ch++) {
    radio.setChannel(ch);
    delay(5);
    if (radio.testCarrier()) {
      tft.setCursor(10, y);
      tft.printf("Noise on ch %d", ch);
      y += 20;
      if (y > 280) break;
    }
    if (readButtonOnce(BTN_LEFT)) break;
  }
  tft.setCursor(10, y+10);
  tft.print("Press OK to exit");
  while (!readButtonOnce(BTN_OK)) delay(50);
}

#endif