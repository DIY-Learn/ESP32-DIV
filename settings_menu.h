#ifndef SETTINGS_MENU_H
#define SETTINGS_MENU_H

#include <TFT_eSPI.h>
#include <SPIFFS.h>

extern TFT_eSPI tft;
extern bool readButtonOnce(int pin);
extern void drawStatusBarBright();
extern void drawRoundedIcon(int x, int y, int w, int h, const uint16_t* icon, int radius);
extern bool feature_exit_requested;
extern bool feature_active;
extern int settingsSelected;   // declared in main.ino

// Pin definitions (same as tools_menu)
#define FAN_PIN      37
#define LED_PIN      38
#define VIBE_PIN     39
//#define BACKLIGHT_PIN 5   // comment out if not used

struct Settings {
  uint8_t brightness;   // 0-255 (stored only, no hardware control unless you add it)
  bool fanOn;
  bool ledOn;
  bool vibeOn;
};

Settings currentSettings;
bool settingsChanged = false;

const char* settingsItems[] = {
  "Brightness",
  "Cooling Fan",
  "LED Strip",
  "Vibration Motor",
  "Save & Reboot",
  "About",
  "Back to Main"
};
#define SETTINGS_COUNT 7

// Icons (replace with your own 32x32 RGB565 data)
const uint16_t icon_brightness[] PROGMEM = {0xffff, 0xffff, 0xffff, 0xffff, 0xffff, 0xffff, 0xffff, 0xffff, 0xffff, 0xffff, 0xffff, 0xffff, 0xffff, 0xffff, 0xffff, 0x52aa, 
0x39c7, 0xffdf, 0xffff, 0xffff, 0xffff, 0xffff, 0xffff, 0xffff, 0xffff, 0xffff, 0xffff, 0xffff, 0xffff, 0xffff, 0xffff, 0xffff, 
0xffff, 0xffff, 0xffff, 0xffff, 0xffff, 0xffff, 0xffff, 0xffff, 0xffff, 0xffff, 0xffff, 0xffff, 0xffff, 0xffff, 0xffff, 0x0000, 
0x0000, 0xef7d, 0xffff, 0xffff, 0xffff, 0xffff, 0xffff, 0xffff, 0xffff, 0xffff, 0xffff, 0xffff, 0xffff, 0xffff, 0xffff, 0xffff, 
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0x2945, 0xffdf, 0xffff, 0xffff, 0xffff, 0xffff, 0xffff, 0xffff, 0xffff, 0xffff, 0xffff, 0xffff, 0xffff, 0xffff, 0xffff, 0xffff
};
const uint16_t icon_fan[] PROGMEM = {0xffff, 0xffff, 0xffff, 0xffff, 0xffff, 0xffff, 0xffff, 0xffff, 0xffff, 0xffff, 0xffff, 0xffff, 0xffff, 0xffff, 0xffff, 0xffff, 
0xffff, 0xffff, 0xffff, 0xffff, 0xffff, 0xffff, 0xffff, 0xffff, 0xffff, 0xffff, 0xffff, 0xffff, 0xffff, 0xffff, 0xffff, 0xffff, 
0xffff, 0xffff, 0xffff, 0xffff, 0xffff, 0xffff, 0xffff, 0xffff, 0xffff, 0xffff, 0xdedb, 0x8c51, 0x4a69, 0x2945, 0x31a6, 0x6b6d, 
0xf79e, 0xffff, 0xffff, 0xffff, 0xffff, 0xffff, 0xffff, 0xffff, 0xffff, 0xffff, 0xffff, 0xffff, 0xffff, 0xffff, 0xffff, 0xffff, 
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0xffff, 0xffff, 0xffff, 0xffff, 0xffff, 0xffff, 0xffff, 0xffff, 0xffff, 0xffff, 0xffff, 0xffff, 0xffff, 0xffff, 0xffff, 0xffff};
const uint16_t icon_led[] PROGMEM = {0xffff, 0xffff, 0xffff, 0xffff, 0xffff, 0xffff, 0xffff, 0xffff, 0xffff, 0xffff, 0xffff, 0xffff, 0xffff, 0xffff, 0xffff, 0xf7be, 
0xf7be, 0xffff, 0xffff, 0xffff, 0xffff, 0xffff, 0xffff, 0xffff, 0xffff, 0xffff, 0xffff, 0xffff, 0xffff, 0xffff, 0xffff, 0xffff, 
0xffff, 0xffff, 0xffff, 0xffff, 0xffff, 0xffff, 0xffff, 0xffff, 0xffff, 0xffff, 0xffff, 0xffff, 0xffff, 0xffff, 0xffff, 0x73ae, 
0x630c, 0xffff, 0xffff, 0xffff, 0xffff, 0xffff, 0xffff, 0xffff, 0xffff, 0xffff, 0xffff, 0xffff, 0xffff, 0xffff, 0xffff, 0xffff, 
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0xffff, 0xe73c, 0xe73c, 0xffff, 0xffff, 0xffff, 0xffff, 0xffff, 0xffff, 0xffff, 0xffff, 0xffff, 0xffff, 0xffff, 0xffff, 0xffff};
const uint16_t icon_vibe[] PROGMEM = {0xffff, 0xffff, 0xffff, 0xffff, 0xffff, 0xffff, 0xffff, 0xffff, 0xffff, 0xffff, 0xffff, 0xffff, 0xffff, 0xffff, 0xffff, 0xffff, 
0xffff, 0xffff, 0xffff, 0xffff, 0xffff, 0xffff, 0xffff, 0xffff, 0xffff, 0xffff, 0xffff, 0xffff, 0xffff, 0xffff, 0xffff, 0xffff, 
0xffff, 0xffff, 0xffff, 0xffff, 0xffff, 0xffff, 0xffff, 0xffff, 0xffff, 0xffff, 0xffff, 0xffff, 0xffff, 0xffff, 0xffff, 0xffff, 
0xffff, 0xffff, 0xffff, 0xffff, 0xffff, 0xffff, 0xffff, 0xffff, 0xffff, 0xffff, 0xffff, 0xffff, 0xffff, 0xffff, 0xffff, 0xffff, 
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0xffff, 0xffff, 0xffff, 0xffff, 0xffff, 0xffff, 0xffff, 0xffff, 0xffff, 0xffff, 0xffff, 0xffff, 0xffff, 0xffff, 0xffff, 0xffff};
const uint16_t icon_save[] PROGMEM = {0xffff, 0xffff, 0xffff, 0xffff, 0xffff, 0xffff, 0xffff, 0xffff, 0xffff, 0xffff, 0xffff, 0xffff, 0xffff, 0xffff, 0xffff, 0xffff, 
0xffff, 0xffff, 0xffff, 0xffff, 0xffff, 0xffff, 0xffff, 0xffff, 0xffff, 0xffff, 0xffff, 0xffff, 0xffff, 0xffff, 0xffff, 0xffff, 
0xffff, 0xffff, 0xffff, 0x9cf3, 0x39c7, 0x4208, 0x4208, 0x39e7, 0x39e7, 0x39e7, 0x39e7, 0x39e7, 0x39e7, 0x39e7, 0x39e7, 0x39e7, 
0x4208, 0x39e7, 0x39e7, 0x39e7, 0x4208, 0x39e7, 0x4208, 0x4208, 0x39e7, 0x31a6, 0xf79e, 0xffff, 0xffff, 0xffff, 0xffff, 0xffff, 
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0x9cf3, 0x9cf3, 0x9cf3, 0x9cf3, 0x9cf3, 0x9cf3, 0x9cf3, 0x9cf3, 0xb596, 0xbdd7, 0x9cd3, 0xa514, 0xf7be, 0xffff, 0xffff, 0xffff
};
const uint16_t icon_about[] PROGMEM = {0xffff, 0xffff, 0xffff, 0xffff, 0xffff, 0xffff, 0xffff, 0xffff, 0xffff, 0xffff, 0xffff, 0xffff, 0xffff, 0xffff, 0xffff, 0xffff, 
0xffff, 0xffff, 0xffff, 0xffff, 0xffff, 0xffff, 0xffff, 0xffff, 0xffff, 0xffff, 0xffff, 0xffff, 0xffff, 0xffff, 0xffff, 0xffff, 
0xffff, 0xffff, 0xffff, 0xffff, 0xffff, 0xffff, 0xffff, 0xffff, 0xffff, 0xffff, 0xffff, 0xffff, 0xffff, 0xffff, 0xffff, 0xffff, 
0xffff, 0xffff, 0xffff, 0xffff, 0xffff, 0xffff, 0xffff, 0xffff, 0xffff, 0xffff, 0xffff, 0xffff, 0xffff, 0xffff, 0xffff, 0xffff, 
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0xffff, 0xffff, 0xffff, 0xffff, 0xffff, 0xffff, 0xffff, 0xffff, 0xffff, 0xffff, 0xffff, 0xffff, 0xffff, 0xffff, 0xffff, 0xffff};
const uint16_t icon_back_set[] PROGMEM = {0xffff, 0xffff, 0xffff, 0xffff, 0xffff, 0xffff, 0xffff, 0xffff, 0xffff, 0xffff, 0xffff, 0xffff, 0xffff, 0xffff, 0xffff, 0xffff, 
0xffff, 0xffff, 0xffff, 0xffff, 0xffff, 0xffff, 0xffff, 0xffff, 0xffff, 0xffff, 0xffff, 0xffff, 0xffff, 0xffff, 0xffff, 0xffff, 
0xffff, 0xffff, 0xffff, 0xffff, 0xffff, 0xffff, 0xffff, 0xffff, 0xffff, 0xffff, 0xffff, 0xffff, 0xffff, 0xffff, 0xffff, 0xffff, 
0xffff, 0xffff, 0xffff, 0xffff, 0xffff, 0xffff, 0xffff, 0xffff, 0xffff, 0xffff, 0xffff, 0xffff, 0xffff, 0xffff, 0xffff, 0xffff, 
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0xffff, 0xffff, 0xffff, 0xffff, 0xffff, 0xffff, 0xffff, 0xffff, 0xffff, 0xffff, 0xffff, 0xffff, 0xffff, 0xffff, 0xffff, 0xffff};

void drawSettingsMenu();
bool handleSettingsMenu();
void loadSettings();
void saveSettings();
void setBacklight(uint8_t level);
void applyHardware();

// ---------- Helper: load settings from SPIFFS ----------
void loadSettings() {
  if (!SPIFFS.begin(true)) {
    Serial.println("SPIFFS mount failed for settings");
    return;
  }
  if (SPIFFS.exists("/settings.bin")) {
    File f = SPIFFS.open("/settings.bin", FILE_READ);
    if (f) {
      f.read((uint8_t*)&currentSettings, sizeof(Settings));
      f.close();
    }
  } else {
    // Default values
    currentSettings.brightness = 200;
    currentSettings.fanOn = false;
    currentSettings.ledOn = false;
    currentSettings.vibeOn = false;
  }
  applyHardware();
}

// ---------- Save settings to SPIFFS ----------
void saveSettings() {
  if (!SPIFFS.begin(true)) {
    Serial.println("SPIFFS mount failed for save");
    return;
  }
  File f = SPIFFS.open("/settings.bin", FILE_WRITE);
  if (f) {
    f.write((uint8_t*)&currentSettings, sizeof(Settings));
    f.close();
    tft.fillRect(10, 200, 220, 30, BG);
    tft.setTextColor(GREEN, BG);
    tft.setCursor(10, 200);
    tft.print("Settings saved!");
    delay(1500);
  } else {
    tft.fillRect(10, 200, 220, 30, BG);
    tft.setTextColor(RED, BG);
    tft.setCursor(10, 200);
    tft.print("Save failed!");
    delay(1500);
  }
}

// ---------- Set backlight (dummy if no hardware) ----------
void setBacklight(uint8_t level) {
  // If you have a backlight pin connected to a PWM-capable GPIO,
  // uncomment the lines below and define BACKLIGHT_PIN.
  // Otherwise, this function does nothing.
  #ifdef BACKLIGHT_PIN
    ledcSetup(0, 5000, 8);
    ledcAttachPin(BACKLIGHT_PIN, 0);
    ledcWrite(0, level);
  #else
    (void)level; // suppress unused parameter warning
  #endif
}

// ---------- Apply hardware states ----------
void applyHardware() {
  digitalWrite(FAN_PIN, currentSettings.fanOn ? HIGH : LOW);
  digitalWrite(LED_PIN, currentSettings.ledOn ? HIGH : LOW);
  digitalWrite(VIBE_PIN, currentSettings.vibeOn ? HIGH : LOW);
  setBacklight(currentSettings.brightness);
}

// ---------- Draw menu ----------
void drawSettingsMenu() {
  tft.fillRect(0, 23, 240, 297, BG);
  drawStatusBarBright();
  tft.setTextColor(WHITE, BG);
  tft.setTextSize(1);
  tft.setCursor(10, 35);
  tft.print("Settings");

  for (int i = 0; i < SETTINGS_COUNT; i++) {
    int y = 55 + i * 36;
    if (i == SETTINGS_COUNT - 1) y += 5;
    uint16_t color = (i == settingsSelected) ? SELECT : GREEN;
    tft.setTextColor(color, BG);
    int iconX = 10;
    int iconY = y - 12;
    const uint16_t* iconPtr = nullptr;
    switch (i) {
      case 0: iconPtr = icon_brightness; break;
      case 1: iconPtr = icon_fan; break;
      case 2: iconPtr = icon_led; break;
      case 3: iconPtr = icon_vibe; break;
      case 4: iconPtr = icon_save; break;
      case 5: iconPtr = icon_about; break;
      case 6: iconPtr = icon_back_set; break;
    }
    drawRoundedIcon(iconX, iconY, 32, 32, iconPtr, 6);
    tft.setCursor(50, y);
    tft.print(settingsItems[i]);
    
    if (i == 1 || i == 2 || i == 3) {
      tft.setCursor(180, y);
      tft.setTextColor((i == settingsSelected) ? SELECT : (currentSettings.fanOn ? GREEN : RED), BG);
      if (i == 1) tft.print(currentSettings.fanOn ? "ON " : "OFF");
      if (i == 2) tft.print(currentSettings.ledOn ? "ON " : "OFF");
      if (i == 3) tft.print(currentSettings.vibeOn ? "ON " : "OFF");
    } else if (i == 0) {
      tft.setCursor(180, y);
      tft.setTextColor((i == settingsSelected) ? SELECT : WHITE, BG);
      tft.printf("%3d", currentSettings.brightness);
    }
  }
}

// ---------- Menu handler ----------
bool handleSettingsMenu() {
  static bool adjustingBrightness = false;
  static int oldBrightness;
  int old = settingsSelected;
  bool redraw = false;

  if (!adjustingBrightness) {
    if (readButtonOnce(BTN_UP)) {
      settingsSelected = (settingsSelected - 1 + SETTINGS_COUNT) % SETTINGS_COUNT;
      redraw = true;
    }
    else if (readButtonOnce(BTN_DOWN)) {
      settingsSelected = (settingsSelected + 1) % SETTINGS_COUNT;
      redraw = true;
    }
    else if (readButtonOnce(BTN_OK)) {
      if (settingsSelected == 6) { // Back
        if (settingsChanged) {
          tft.fillRect(10, 200, 220, 30, BG);
          tft.setTextColor(YELLOW, BG);
          tft.setCursor(10, 200);
          tft.print("Save changes? (OK=Yes, LEFT=No)");
          while (true) {
            if (readButtonOnce(BTN_OK)) {
              saveSettings();
              settingsChanged = false;
              break;
            } else if (readButtonOnce(BTN_LEFT)) {
              loadSettings(); // discard changes
              settingsChanged = false;
              break;
            }
            delay(50);
          }
        }
        return true; // exit to main menu
      }
      else if (settingsSelected == 4) { // Save & Reboot
        saveSettings();
        tft.fillRect(10, 200, 220, 30, BG);
        tft.setTextColor(GREEN, BG);
        tft.setCursor(10, 200);
        tft.print("Rebooting in 3 sec...");
        delay(3000);
        ESP.restart();
      }
      else if (settingsSelected == 5) { // About
        tft.fillRect(0, 23, 240, 297, BG);
        drawStatusBarBright();
        tft.setTextColor(WHITE, BG);
        tft.setCursor(10, 35);
        tft.print("About");
        tft.setCursor(10, 55);
        tft.print("Flipper Zero Clone");
        tft.setCursor(10, 75);
        tft.print("Firmware v1.0");
        tft.setCursor(10, 95);
        tft.print("ESP32-S3 with 2.4\" LCD");
        tft.setCursor(10, 115);
        tft.print("IR, BT, WiFi, 2.4GHz, SubGHz");
        tft.setCursor(10, 135);
        tft.print("Press OK to return");
        while (!readButtonOnce(BTN_OK)) delay(50);
        drawSettingsMenu();
        redraw = false;
      }
      else if (settingsSelected == 0) {
        adjustingBrightness = true;
        oldBrightness = currentSettings.brightness;
      }
      else if (settingsSelected >= 1 && settingsSelected <= 3) {
        bool* target = nullptr;
        if (settingsSelected == 1) target = &currentSettings.fanOn;
        else if (settingsSelected == 2) target = &currentSettings.ledOn;
        else if (settingsSelected == 3) target = &currentSettings.vibeOn;
        *target = !(*target);
        applyHardware();
        int yPos = 55 + settingsSelected * 36;
        tft.fillRect(180, yPos - 8, 40, 20, BG);
        tft.setTextColor(SELECT, BG);
        tft.setCursor(180, yPos);
        tft.print(*target ? "ON " : "OFF");
        settingsChanged = true;
        redraw = false;
      }
    }
  } else {
    // Brightness adjustment mode
    if (readButtonOnce(BTN_UP)) {
      if (currentSettings.brightness < 255) currentSettings.brightness += 5;
      if (currentSettings.brightness > 255) currentSettings.brightness = 255;
      setBacklight(currentSettings.brightness);
      settingsChanged = true;
      int yPos = 55 + 0 * 36;
      tft.fillRect(180, yPos - 8, 40, 20, BG);
      tft.setTextColor(SELECT, BG);
      tft.setCursor(180, yPos);
      tft.printf("%3d", currentSettings.brightness);
    }
    else if (readButtonOnce(BTN_DOWN)) {
      if (currentSettings.brightness >= 5) currentSettings.brightness -= 5;
      else currentSettings.brightness = 0;
      setBacklight(currentSettings.brightness);
      settingsChanged = true;
      int yPos = 55 + 0 * 36;
      tft.fillRect(180, yPos - 8, 40, 20, BG);
      tft.setTextColor(SELECT, BG);
      tft.setCursor(180, yPos);
      tft.printf("%3d", currentSettings.brightness);
    }
    else if (readButtonOnce(BTN_OK) || readButtonOnce(BTN_LEFT)) {
      adjustingBrightness = false;
      if (readButtonOnce(BTN_LEFT)) {
        currentSettings.brightness = oldBrightness;
        setBacklight(currentSettings.brightness);
        settingsChanged = false;
      } else {
        settingsChanged = true;
      }
      redraw = true;
    }
  }

  if (redraw) {
    drawSettingsMenu();
  }
  return false;
}

#endif